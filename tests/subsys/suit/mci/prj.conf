## CMakeLists.txt
```
#
# Copyright (c) 2023 Nordic Semiconductor ASA
#
# SPDX-License-Identifier: LicenseRef-Nordic-5-Clause
#

cmake_minimum_required(VERSION 3.20.0)

find_package(Zephyr REQUIRED HINTS $ENV{ZEPHYR_BASE})

project(integration_test_suit_mci)
include(../cmake/test_template.cmake)

# Link with the CMake target, that includes SUIT platform internal APIs header
zephyr_library_link_libraries(suit_mci)
```

## prj.conf
```kconfig
#
# Copyright (c) 2023 Nordic Semiconductor ASA
#
# SPDX-License-Identifier: LicenseRef-Nordic-5-Clause
#

CONFIG_ZTEST=y

CONFIG_SUIT=y
CONFIG_SUIT_MCI=y
```

## boards/nrf54h20dk_nrf54h20_cpusec.conf
```kconfig
#
# Copyright (c) 2023 Nordic Semiconductor ASA
#
# SPDX-License-Identifier: LicenseRef-Nordic-5-Clause
#

CONFIG_NULL_POINTER_EXCEPTION_DETECTION_NONE=y
CONFIG_SERIAL=y
CONFIG_CONSOLE=y
CONFIG_UART_CONSOLE=y

# This test does not set 'IS_SECURE_DOMAIN_FW'. Hence, we need to enable some
# options to get the system in a verifiable state
CONFIG_SECDOM_UNIT_TEST_SUPPORT=y
CONFIG_SDFW_BOOT_LIBRARY=y
CONFIG_SDFW_SOC_INIT_COMMON=y

# Logging and printk is using standard UART.
CONFIG_LOG_MODE_DEFERRED=y
CONFIG_LOG_BACKEND_UART=y
CONFIG_LOG_PRINTK=y
CONFIG_LOG_BUFFER_SIZE=8192
```

## src/main.c
```c
/*
 * Copyright (c) 2023 Nordic Semiconductor ASA
 *
 * SPDX-License-Identifier: LicenseRef-Nordic-5-Clause
 */
#include <zephyr/ztest.h>
#include <suit_mci.h>

void test_generic_ids(void);
void test_sanity(void);
void test_api_positive_scenarios(void);
void test_topology(void);

void test_main(void)
{
	suit_mci_init();
	test_generic_ids();
	test_sanity();
	test_api_positive_scenarios();
	test_topology();
}
```

## src/api_positive_scenarios.c
```c
/*
 * Copyright (c) 2023 Nordic Semiconductor ASA
 *
 * SPDX-License-Identifier: LicenseRef-Nordic-5-Clause
 */
#include <zephyr/ztest.h>
#include <suit_mci.h>

#define OUTPUT_MAX_SIZE 32
static const suit_uuid_t *result_uuid[OUTPUT_MAX_SIZE];

static void test_suit_mci_supported_manifest_class_ids_get(void)
{
	int rc = 0;
	size_t output_size = OUTPUT_MAX_SIZE;

	rc = suit_mci_supported_manifest_class_ids_get(result_uuid, &output_size);
	zassert_equal(rc, SUIT_PLAT_SUCCESS,
		      "suit_mci_supported_manifest_class_ids_get returned (%d)", rc);
}

static void test_suit_mci_invoke_order_get(void)
{
	int rc = 0;
	size_t output_size = OUTPUT_MAX_SIZE;

	rc = suit_mci_invoke_order_get(result_uuid, &output_size);
	zassert_equal(rc, SUIT_PLAT_SUCCESS, "suit_mci_invoke_order_get returned (%d)", rc);
}

static void test_suit_mci_downgrade_prevention_policy_get(void)
{
	int rc = 0;
	size_t output_size = OUTPUT_MAX_SIZE;

	rc = suit_mci_supported_manifest_class_ids_get(result_uuid, &output_size);
	zassert_equal(rc, SUIT_PLAT_SUCCESS,
		      "suit_mci_supported_manifest_class_ids_get returned (%d)", rc);

	for (int i = 0; i < output_size; ++i) {
		downgrade_prevention_policy_t policy;

		rc = suit_mci_downgrade_prevention_policy_get(result_uuid[i], &policy);
		zassert_equal(rc, SUIT_PLAT_SUCCESS,
			      "suit_mci_downgrade_prevention_policy_get returned (%d)", rc);
	}
}

static void test_suit_mci_manifest_class_id_validate(void)
{
	int rc = 0;
	size_t output_size = OUTPUT_MAX_SIZE;

	rc = suit_mci_supported_manifest_class_ids_get(result_uuid, &output_size);
	zassert_equal(rc, SUIT_PLAT_SUCCESS,
		      "suit_mci_supported_manifest_class_ids_get returned (%d)", rc);

	for (int i = 0; i < output_size; ++i) {
		rc = suit_mci_manifest_class_id_validate(result_uuid[i]);
		zassert_equal(rc, SUIT_PLAT_SUCCESS,
			      "suit_mci_manifest_class_id_validate returned (%d)", rc);
	}
}

static void test_suit_mci_signing_key_id_validate(void)
{
	int rc = 0;
	size_t output_size = OUTPUT_MAX_SIZE;

	rc = suit_mci_supported_manifest_class_ids_get(result_uuid, &output_size);
	zassert_equal(rc, SUIT_PLAT_SUCCESS,
		      "suit_mci_supported_manifest_class_ids_get returned (%d)", rc);

	for (int i = 0; i < output_size; ++i) {
		uint32_t key_id = 0;

		rc = suit_mci_signing_key_id_validate(result_uuid[i], key_id);
		zassert_true((MCI_ERR_NOACCESS == rc || SUIT_PLAT_SUCCESS == rc),
			     "suit_mci_signing_key_id_validate returned (%d)", rc);
	}
}

static void test_suit_mci_processor_start_rights_validate(void)
{
	int rc = 0;
	size_t output_size = OUTPUT_MAX_SIZE;

	rc = suit_mci_supported_manifest_class_ids_get(result_uuid, &output_size);
	zassert_equal(rc, SUIT_PLAT_SUCCESS,
		      "suit_mci_supported_manifest_class_ids_get returned (%d)", rc);

	for (int i = 0; i < output_size; ++i) {
		int processor_id = 0;

		rc = suit_mci_processor_start_rights_validate(result_uuid[i], processor_id);
		zassert_true((MCI_ERR_NOACCESS == rc || SUIT_PLAT_SUCCESS == rc),
			     "suit_mci_processor_start_rights_validate returned (%d)", rc);
	}
}

static void test_suit_mci_memory_access_rights_validate(void)
{
	int rc = 0;
	size_t output_size = OUTPUT_MAX_SIZE;

	rc = suit_mci_supported_manifest_class_ids_get(result_uuid, &output_size);
	zassert_equal(rc, SUIT_PLAT_SUCCESS,
		      "suit_mci_supported_manifest_class_ids_get returned (%d)", rc);

	for (int i = 0; i < output_size; ++i) {
		void *address = &address;
		size_t mem_size = sizeof(void *);

		rc = suit_mci_memory_access_rights_validate(result_uuid[i], address, mem_size);
		zassert_true((MCI_ERR_NOACCESS == rc || SUIT_PLAT_SUCCESS == rc),
			     "suit_mci_memory_access_rights_validate returned (%d)", rc);
	}
}

static void test_suit_mci_platform_specific_component_rights_validate(void)
{
	int rc = 0;
	size_t output_size = OUTPUT_MAX_SIZE;

	rc = suit_mci_supported_manifest_class_ids_get(result_uuid, &output_size);
	zassert_equal(rc, SUIT_PLAT_SUCCESS,
		      "suit_mci_supported_manifest_class_ids_get returned (%d)", rc);

	for (int i = 0; i < output_size; ++i) {
		int platform_specific_component_number = 0;

		rc = suit_mci_platform_specific_component_rights_validate(
			result_uuid[i], platform_specific_component_number);
		zassert_true((MCI_ERR_NOACCESS == rc || SUIT_PLAT_SUCCESS == rc),
			     "suit_mci_platform_specific_component_rights_validate returned (%d)",
			     rc);
	}
}

static void test_suit_mci_manifest_parent_child_validate(void)
{
	int rc = 0;
	size_t output_size = OUTPUT_MAX_SIZE;

	rc = suit_mci_supported_manifest_class_ids_get(result_uuid, &output_size);
	zassert_equal(rc, SUIT_PLAT_SUCCESS,
		      "suit_mci_supported_manifest_class_ids_get returned (%d)", rc);

	for (int i = 0; i < output_size; ++i) {

		rc = suit_mci_manifest_parent_child_validate(result_uuid[0], result_uuid[i]);
		zassert_true((MCI_ERR_NOACCESS == rc || SUIT_PLAT_SUCCESS == rc),
			     "suit_mci_manifest_parent_child_validate returned (%d)", rc);
	}
}

static void test_suit_mci_vendor_id_for_manifest_class_id_get(void)
{
	int rc = 0;
	size_t output_size = OUTPUT_MAX_SIZE;

	rc = suit_mci_supported_manifest_class_ids_get(result_uuid, &output_size);
	zassert_equal(rc, SUIT_PLAT_SUCCESS,
		      "suit_mci_supported_manifest_class_ids_get returned (%d)", rc);

	for (int i = 0; i < output_size; ++i) {
		const suit_uuid_t *vendor_id = NULL;

		rc = suit_mci_vendor_id_for_manifest_class_id_get(result_uuid[i], &vendor_id);
		zassert_equal(rc, SUIT_PLAT_SUCCESS,
			      "suit_mci_vendor_id_for_manifest_class_id_get returned (%d)", rc);
	}
}

void test_api_positive_scenarios(void)
{
	ztest_test_suite(test_suit_mci_api,
			 ztest_unit_test(test_suit_mci_supported_manifest_class_ids_get),
			 ztest_unit_test(test_suit_mci_invoke_order_get),
			 ztest_unit_test(test_suit_mci_downgrade_prevention_policy_get),
			 ztest_unit_test(test_suit_mci_signing_key_id_validate),
			 ztest_unit_test(test_suit_mci_manifest_class_id_validate),
			 ztest_unit_test(test_suit_mci_processor_start_rights_validate),
			 ztest_unit_test(test_suit_mci_memory_access_rights_validate),
			 ztest_unit_test(test_suit_mci_platform_specific_component_rights_validate),
			 ztest_unit_test(test_suit_mci_manifest_parent_child_validate),
			 ztest_unit_test(test_suit_mci_vendor_id_for_manifest_class_id_get));

	ztest_run_test_suite(test_suit_mci_api);
}
```

## src/generic_ids.c
```c
/*
 * Copyright (c) 2023 Nordic Semiconductor ASA
 *
 * SPDX-License-Identifier: LicenseRef-Nordic-5-Clause
 */
#include <zephyr/ztest.h>
#include <suit_mci.h>

static void test_mci_nordic_vendor_id_value(void)
{

	suit_uuid_t expected_vid = {{0x76, 0x17, 0xda, 0xa5, 0x71, 0xfd, 0x5a, 0x85, 0x8f, 0x94,
				     0xe2, 0x8d, 0x73, 0x5c, 0xe9, 0xf4}};

	const suit_uuid_t *obtained_vid = NULL;
	mci_err_t rc = SUIT_PLAT_SUCCESS;

	rc = suit_mci_nordic_vendor_id_get(&obtained_vid);
	zassert_equal(rc, SUIT_PLAT_SUCCESS, "suit_mci_nordic_vendor_id_get returned (%d)", rc);
	zassert_not_null(obtained_vid, "obtained_vid points to NULL");
	zassert_mem_equal(obtained_vid->raw, expected_vid.raw, sizeof(((suit_uuid_t *)0)->raw),
			  "unexpected vendor_id");
}

static void test_mci_nordic_unspecified_class_id_value(void)
{

	suit_uuid_t expected_cid = {{0xca, 0xd8, 0x52, 0x3a, 0xf8, 0x29, 0x5a, 0x9a, 0xba, 0x85,
				     0x2e, 0xa0, 0xb2, 0xf5, 0x77, 0xc9}};

	const suit_uuid_t *obtained_cid = NULL;
	mci_err_t rc = SUIT_PLAT_SUCCESS;

	rc = suit_mci_nordic_unspecified_class_id_get(&obtained_cid);
	zassert_equal(rc, SUIT_PLAT_SUCCESS,
		      "suit_mci_nordic_unspecified_class_id_get returned (%d)", rc);
	zassert_not_null(obtained_cid, "obtained_cid points to NULL");
	zassert_mem_equal(obtained_cid->raw, expected_cid.raw, sizeof(((suit_uuid_t *)0)->raw), "");
}

void test_generic_ids(void)
{
	ztest_test_suite(test_suit_mci_generic_ids,
			 ztest_unit_test(test_mci_nordic_vendor_id_value),
			 ztest_unit_test(test_mci_nordic_unspecified_class_id_value));

	ztest_run_test_suite(test_suit_mci_generic_ids);
}
```

## src/sanity.c
```c
/*
 * Copyright (c) 2023 Nordic Semiconductor ASA
 *
 * SPDX-License-Identifier: LicenseRef-Nordic-5-Clause
 */
#include <zephyr/ztest.h>
#include <suit_mci.h>

#define OUTPUT_MAX_SIZE 32
static const suit_uuid_t *result_uuid[OUTPUT_MAX_SIZE];

static void test_null_pointers(void)
{
	const suit_manifest_class_id_t unsupported_manifest_class_id = {
		{'u', 'n', 's', 'u', 'p', 'p', 'o', 'r', 't', 'e', 'd', '!', '!', '!', ' ', ' '}};
	size_t output_size = OUTPUT_MAX_SIZE;
	uint32_t key_id = 0;
	int processor_id = 0;
	void *mem_address = &mem_address;
	size_t mem_size = sizeof(mem_address);
	int platform_specific_component_number = 0;
	downgrade_prevention_policy_t policy;
	int rc = SUIT_PLAT_SUCCESS;

	rc = suit_mci_nordic_vendor_id_get(NULL);
	zassert_equal(rc, SUIT_PLAT_ERR_INVAL, "suit_mci_nordic_vendor_id_get returned (%d)", rc);

	rc = suit_mci_nordic_unspecified_class_id_get(NULL);
	zassert_equal(rc, SUIT_PLAT_ERR_INVAL,
		      "suit_mci_nordic_unspecified_class_id_get returned (%d)", rc);

	output_size = OUTPUT_MAX_SIZE;
	rc = suit_mci_supported_manifest_class_ids_get(NULL, &output_size);
	zassert_equal(rc, SUIT_PLAT_ERR_INVAL,
		      "suit_mci_supported_manifest_class_ids_get returned (%d)", rc);

	rc = suit_mci_supported_manifest_class_ids_get(result_uuid, NULL);
	zassert_equal(rc, SUIT_PLAT_ERR_INVAL,
		      "suit_mci_supported_manifest_class_ids_get returned (%d)", rc);

	output_size = OUTPUT_MAX_SIZE;
	rc = suit_mci_invoke_order_get(NULL, &output_size);
	zassert_equal(rc, SUIT_PLAT_ERR_INVAL, "suit_mci_invoke_order_get returned (%d)", rc);

	rc = suit_mci_invoke_order_get(result_uuid, NULL);
	zassert_equal(rc, SUIT_PLAT_ERR_INVAL, "suit_mci_invoke_order_get returned (%d)", rc);

	rc = suit_mci_downgrade_prevention_policy_get(NULL, &policy);
	zassert_equal(rc, SUIT_PLAT_ERR_INVAL,
		      "suit_mci_downgrade_prevention_policy_get returned (%d)", rc);

	rc = suit_mci_downgrade_prevention_policy_get(&unsupported_manifest_class_id, NULL);
	zassert_equal(rc, SUIT_PLAT_ERR_INVAL,
		      "suit_mci_downgrade_prevention_policy_get returned (%d)", rc);

	rc = suit_mci_signing_key_id_validate(NULL, key_id);
	zassert_equal(rc, SUIT_PLAT_ERR_INVAL, "suit_mci_signing_key_id_validate returned (%d)",
		      rc);

	rc = suit_mci_manifest_class_id_validate(NULL);
	zassert_equal(rc, SUIT_PLAT_ERR_INVAL, "suit_mci_manifest_class_id_validate returned (%d)",
		      rc);

	rc = suit_mci_processor_start_rights_validate(NULL, processor_id);
	zassert_equal(rc, SUIT_PLAT_ERR_INVAL,
		      "suit_mci_processor_start_rights_validate returned (%d)", rc);

	rc = suit_mci_memory_access_rights_validate(NULL, mem_address, mem_size);
	zassert_equal(rc, SUIT_PLAT_ERR_INVAL,
		      "suit_mci_memory_access_rights_validate returned (%d)", rc);

	rc = suit_mci_memory_access_rights_validate(&unsupported_manifest_class_id, NULL, mem_size);
	zassert_equal(rc, SUIT_PLAT_ERR_INVAL,
		      "suit_mci_memory_access_rights_validate returned (%d)", rc);

	rc = suit_mci_platform_specific_component_rights_validate(
		NULL, platform_specific_component_number);
	zassert_equal(rc, SUIT_PLAT_ERR_INVAL,
		      "suit_mci_platform_specific_component_rights_validate returned (%d)", rc);

	rc = suit_mci_manifest_parent_child_validate(&unsupported_manifest_class_id, NULL);
	zassert_equal(rc, SUIT_PLAT_ERR_INVAL,
		      "suit_mci_manifest_parent_child_validate returned (%d)", rc);

	rc = suit_mci_manifest_parent_child_validate(NULL, &unsupported_manifest_class_id);
	zassert_equal(rc, SUIT_PLAT_ERR_INVAL,
		      "suit_mci_manifest_parent_child_validate returned (%d)", rc);

	rc = suit_mci_vendor_id_for_manifest_class_id_get(NULL, result_uuid);
	zassert_equal(rc, SUIT_PLAT_ERR_INVAL,
		      "suit_mci_vendor_id_for_manifest_class_id_get returned (%d)", rc);

	rc = suit_mci_vendor_id_for_manifest_class_id_get(&unsupported_manifest_class_id, NULL);
	zassert_equal(rc, SUIT_PLAT_ERR_INVAL,
		      "suit_mci_vendor_id_for_manifest_class_id_get returned (%d)", rc);
}

static void test_invalid_params(void)
{
	void *mem_address = &mem_address;
	size_t mem_size = sizeof(mem_address);
	int rc = SUIT_PLAT_SUCCESS;

	rc = suit_mci_memory_access_rights_validate(NULL, mem_address, mem_size);
	zassert_equal(rc, SUIT_PLAT_ERR_INVAL,
		      "suit_mci_memory_access_rights_validate returned (%d)", rc);
}

static void test_output_buffer_too_small(void)
{
	size_t output_size = OUTPUT_MAX_SIZE;
	size_t supported_manifest_count = 0;
	size_t invokable_manifest_count = 0;
	int rc = SUIT_PLAT_SUCCESS;

	output_size = OUTPUT_MAX_SIZE;
	rc = suit_mci_supported_manifest_class_ids_get(result_uuid, &output_size);
	zassert_equal(rc, SUIT_PLAT_SUCCESS,
		      "suit_mci_supported_manifest_class_ids_get returned (%d), isn't %d manifests "
		      "enough?!",
		      rc, OUTPUT_MAX_SIZE);
	supported_manifest_count = output_size;

	output_size = supported_manifest_count;
	rc = suit_mci_supported_manifest_class_ids_get(result_uuid, &output_size);
	zassert_equal(rc, SUIT_PLAT_SUCCESS,
		      "suit_mci_supported_manifest_class_ids_get returned (%d)", rc);

	if (supported_manifest_count > 1) {
		output_size = supported_manifest_count - 1;
		rc = suit_mci_supported_manifest_class_ids_get(result_uuid, &output_size);
		zassert_equal(rc, SUIT_PLAT_ERR_SIZE,
			      "suit_mci_supported_manifest_class_ids_get returned (%d)", rc);
	}

	if (supported_manifest_count > 0) {
		output_size = 0;
		rc = suit_mci_supported_manifest_class_ids_get(result_uuid, &output_size);
		zassert_equal(rc, SUIT_PLAT_ERR_SIZE,
			      "suit_mci_supported_manifest_class_ids_get returned (%d)", rc);
	}

	output_size = OUTPUT_MAX_SIZE;
	rc = suit_mci_invoke_order_get(result_uuid, &output_size);
	zassert_equal(rc, SUIT_PLAT_SUCCESS,
		      "suit_mci_invoke_order_get returned (%d), isn't %d manifests enough?!", rc,
		      OUTPUT_MAX_SIZE);
	invokable_manifest_count = output_size;

	output_size = invokable_manifest_count;
	rc = suit_mci_invoke_order_get(result_uuid, &output_size);
	zassert_equal(rc, SUIT_PLAT_SUCCESS, "suit_mci_invoke_order_get returned (%d)", rc);

	if (invokable_manifest_count > 1) {
		output_size = invokable_manifest_count - 1;
		rc = suit_mci_invoke_order_get(result_uuid, &output_size);
		zassert_equal(rc, SUIT_PLAT_ERR_SIZE, "suit_mci_invoke_order_get returned (%d)",
			      rc);
	}

	if (invokable_manifest_count > 0) {
		output_size = 0;
		rc = suit_mci_invoke_order_get(result_uuid, &output_size);
		zassert_equal(rc, SUIT_PLAT_ERR_SIZE, "suit_mci_invoke_order_get returned (%d)",
			      rc);
	}
}

void test_sanity(void)
{
	ztest_test_suite(test_suit_mci_sanity, ztest_unit_test(test_null_pointers),
			 ztest_unit_test(test_invalid_params),
			 ztest_unit_test(test_output_buffer_too_small));

	ztest_run_test_suite(test_suit_mci_sanity);
}
```

## src/topology.c
```c
/*
 * Copyright (c) 2023 Nordic Semiconductor ASA
 *
 * SPDX-License-Identifier: LicenseRef-Nordic-5-Clause
 */
#include <zephyr/ztest.h>
#include <suit_mci.h>

#define OUTPUT_MAX_SIZE 32
static const suit_uuid_t *result_uuid[OUTPUT_MAX_SIZE];

static int compare_manifest_class_id(const suit_manifest_class_id_t *manifest_class_id1,
				     const suit_manifest_class_id_t *manifest_class_id2)
{
	return memcmp(manifest_class_id1->raw, manifest_class_id2->raw,
		      sizeof(((suit_manifest_class_id_t *)0)->raw));
}

static void test_duplicate_ids_in_supported_manifest(void)
{
	int rc = SUIT_PLAT_SUCCESS;
	size_t output_size = OUTPUT_MAX_SIZE;

	rc = suit_mci_supported_manifest_class_ids_get(result_uuid, &output_size);
	zassert_equal(rc, SUIT_PLAT_SUCCESS,
		      "suit_mci_supported_manifest_class_ids_get returned (%d)", rc);

	for (int i = 0; i < output_size; ++i) {
		for (int j = i + 1; j < output_size; ++j) {
			rc = compare_manifest_class_id(result_uuid[i], result_uuid[j]);
			zassert_true((rc != 0), "the same uuid used for two manifests");
		}
	}
}

static void test_duplicate_ids_in_invoke_order(void)
{
	int rc = SUIT_PLAT_SUCCESS;
	size_t output_size = OUTPUT_MAX_SIZE;

	rc = suit_mci_invoke_order_get(result_uuid, &output_size);
	zassert_equal(rc, SUIT_PLAT_SUCCESS, "suit_mci_invoke_order_get returned (%d)", rc);

	for (int i = 0; i < output_size; ++i) {
		for (int j = i + 1; j < output_size; ++j) {
			rc = compare_manifest_class_id(result_uuid[i], result_uuid[j]);
			zassert_true((rc != 0), "the same uuid used for two manifests");
		}
	}
}

void test_topology(void)
{
	ztest_test_suite(test_suit_mci_topology,
			 ztest_unit_test(test_duplicate_ids_in_supported_manifest),
			 ztest_unit_test(test_duplicate_ids_in_invoke_order));

	ztest_run_test_suite(test_suit_mci_topology);
}
```
