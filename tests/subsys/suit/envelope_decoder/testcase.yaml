## tests/subsys/suit/envelope_decoder/testcase.yaml
```yaml
tests:
  suit-processor.integration.envelope_decoder:
    platform_allow: nrf52840dk_nrf52840 native_posix native_posix_64
    build_only: true
    tags: suit-processor envelope-decoder

  suit-processor.integration.envelope_decoder.fpga:
    platform_allow: nrf54h20dk_nrf54h20_cpusec@soc1
    build_only: true
    tags: suit-processor envelope-decoder fpga
    extra_args: DTC_OVERLAY_FILE=boards/nrf54h20dk_nrf54h20_cpusec.overlay;serial_cpusec.overlay;systick.overlay
    extra_configs:
      - CONFIG_EMULATOR_FPGA=y
```

## tests/subsys/suit/envelope_reference_component/testcase.yaml
```yaml
tests:
  suit-processor.integration.envelope_reference_component:
    platform_allow: nrf52840dk_nrf52840 native_posix native_posix_64
    tags: suit-processor envelope reference component
    integration_platforms:
      - nrf52840dk_nrf52840
      - native_posix
```

## tests/subsys/suit/fetch_integrated_payload/testcase.yaml
```yaml
tests:
  suit-processor.integration.fetch_integrated_payload:
    platform_allow: nrf52840dk_nrf52840 native_posix native_posix_64
    tags: suit-processor integrated-payload fetch
    integration_platforms:
      - nrf52840dk_nrf52840
      - native_posix

  suit-processor.integration.fetch_integrated_payload.fpga:
    platform_allow: nrf54h20dk_nrf54h20_cpusec@soc1
    tags: suit-processor integrated-payload fetch fpga
    extra_args: DTC_OVERLAY_FILE=boards/nrf54h20dk_nrf54h20_cpusec.overlay;systick.overlay
    extra_configs:
      - CONFIG_EMULATOR_FPGA=y
```

## tests/subsys/suit/fetch_integrated_payload_flash/testcase.yaml
```yaml
tests:
  suit-processor.integration.fetch_integrated_payload_flash:
    platform_allow: nrf52840dk_nrf52840 native_posix native_posix_64
    tags: suit-processor integrated-payload fetch MRAM
    integration_platforms:
      - nrf52840dk_nrf52840
      - native_posix

  suit-processor.integration.fetch_integrated_payload_flash.fpga:
    extra_args: CONFIG_EMULATOR_FPGA=y
    platform_allow: nrf54h20dk_nrf54h20_cpusec
    tags: suit-processor integrated-payload fetch MRAM fpga
```

## tests/subsys/suit/invoke/testcase.yaml
```yaml
tests:
  suit-platform.integration.invoke:
    platform_allow: native_posix native_posix_64
    tags: suit-processor suit_platform
    integration_platforms:
      - native_posix
      - native_posix_64

  suit-platform.integration.invoke.nrf54h20:
    platform_allow: nrf54h20dk_nrf54h20_cpusec@soc1
    tags: suit-processor suit_platform
    integration_platforms:
      - nrf54h20dk_nrf54h20_cpusec@soc1
    extra_args: DTC_OVERLAY_FILE=boards/nrf54h20dk_nrf54h20_cpusec.overlay;serial_cpusec.overlay;systick.overlay
```

## tests/subsys/suit/mci/testcase.yaml
```yaml
tests:
  suit-processor.integration.suit_mci:
    platform_allow: native_posix native_posix_64
    tags: suit-mci
    integration_platforms:
      - native_posix

  suit-processor.integration.suit_mci.nrf54h20:
    platform_allow: nrf54h20dk_nrf54h20_cpusec@soc1
    tags: suit-mci
    integration_platforms:
      - nrf54h20dk_nrf54h20_cpusec@soc1
    extra_args: DTC_OVERLAY_FILE=boards/nrf54h20dk_nrf54h20_cpusec.overlay;serial_cpusec.overlay;systick.overlay

  suit-processor.integration.suit_mci.fpga:
    platform_allow: nrf54h20dk_nrf54h20_cpusec@soc1
    tags: suit-mci fpga
    timeout: 240
    extra_args: DTC_OVERLAY_FILE=boards/nrf54h20dk_nrf54h20_cpusec.overlay;serial_cpusec.overlay;systick.overlay
    extra_configs:
      - CONFIG_EMULATOR_FPGA=y
```

## tests/subsys/suit/orchestrator/testcase.yaml
```yaml
tests:
  suit.integration.orchestrator:
    platform_allow: nrf52840dk_nrf52840 native_posix native_posix_64
    tags: suit suit_orchestrator
    timeout: 240
    integration_platforms:
      - nrf52840dk_nrf52840
      - native_posix

  suit.integration.orchestrator.fpga:
    platform_allow: nrf54h20dk_nrf54h20_cpusec@soc1
    tags: suit suit_orchestrator fpga
    timeout: 240
    extra_args: DTC_OVERLAY_FILE=boards/nrf54h20dk_nrf54h20_cpusec.overlay;serial_cpusec.overlay;systick.overlay
    extra_configs:
      - CONFIG_EMULATOR_FPGA=y
```

## tests/subsys/suit/storage/testcase.yaml
```yaml
tests:
  suit-processor.integration.suit_storage:
    platform_allow: nrf52840dk_nrf52840 native_posix native_posix_64
    tags: suit-processor suit_storage
    integration_platforms:
      - nrf52840dk_nrf52840
      - native_posix

  suit-processor.integration.suit_storage.fpga:
    platform_allow: nrf54h20dk_nrf54h20_cpusec@soc1
    tags: suit-processor suit_storage fpga
    timeout: 240
    extra_args: DTC_OVERLAY_FILE=boards/nrf54h20dk_nrf54h20_cpusec.overlay;serial_cpusec.overlay;systick.overlay
    extra_configs:
      - CONFIG_EMULATOR_FPGA=y
```

## tests/subsys/suit/suit_storage/testcase.yaml
```yaml
tests:
  suit-processor.integration.suit_storage:
    platform_allow: nrf52840dk_nrf52840 native_posix native_posix_64
    tags: suit-processor suit_storage
    integration_platforms:
      - nrf52840dk_nrf52840
      - native_posix

  suit-processor.integration.suit_storage.fpga:
    extra_args: CONFIG_EMULATOR_FPGA=y
    platform_allow: nrf54h20dk_nrf54h20_cpusec
    tags: suit-processor suit_storage fpga
```

## tests/subsys/suit/unit/suit_plat_authenticate/testcase.yaml
```yaml
tests:
  suit.unit.platform.suit_plat_authenticate:
    type: unit
    tags: >-
      suit
      suit_platform
      suit_plat_authenticate_manifest
```

## tests/subsys/suit/unit/suit_plat_check_component_compatibility/testcase.yaml
```yaml
tests:
  suit.unit.platform.suit_plat_check_component_compatibility:
    type: unit
    tags: >-
      suit
      suit_platform
      suit_plat_check_component_compatibility
```

## tests/subsys/suit/unit/suit_plat_check_component_id/testcase.yaml
```yaml
tests:
  suit.unit.platform.suit_plat_check_component_id:
    type: unit
    tags: >-
      suit
      suit_platform
      suit_plat_check_component_id
```

## tests/tfm/hello_world/testcase.yaml
```yaml
tests:
  tfm.hello_world:
    platform_allow: nrf54l15dk_nrf54l15_cpuapp_ns@soc1
    tags: tfm
    integration_platforms:
      - nrf54l15dk_nrf54l15_cpuapp_ns@soc1
```

## tests/unity/Kconfig
```kconfig
#
# Copyright (c) 2019 Nordic Semiconductor
#
# SPDX-License-Identifier: LicenseRef-Nordic-5-Clause
#

rsource "fake_event_manager/Kconfig"

config UNITY
	bool "Use Unity test framework"
```

## tests/unity/fake_event_manager/Kconfig
```kconfig
#
# Copyright (c) 2022 Nordic Semiconductor
#
# SPDX-License-Identifier: Apache-2.0
#

config FAKE_EVENT_MANAGER
	bool "Use Fake Event Manager."
	depends on UNITY
	depends on !EVENT_MANAGER
	help
	  Use this module if you need to test application using
	  event manager
```

## west.yml
```yaml
# The west manifest file (west.yml) for the nRF Connect SDK (NCS).
#
# The per-workspace west configuration file, ncs/.west/config,
# specifies the location of this manifest file like this:
#
#     [manifest]
#     path = nrf
#
# See the west documentation for more information:
#
# https://developer.nordicsemi.com/nRF_Connect_SDK/doc/latest/zephyr/guides/west/index.html

manifest:
  version: "0.13"

  # "remotes" is a list of locations where git repositories are cloned
  # and fetched from.
  remotes:
    # nRF Connect SDK GitHub organization.
    # NCS repositories are hosted here.
    - name: ncs
      url-base: https://github.com/nrfconnect
    # Third-party repository sources:
    - name: zephyrproject
      url-base: https://github.com/zephyrproject-rtos
    - name: throwtheswitch
      url-base: https://github.com/ThrowTheSwitch
    - name: armmbed
      url-base: https://github.com/ARMmbed
    - name: nordicsemi
      url-base: https://github.com/NordicSemiconductor
    - name: dragoon
      url-base: https://projecttools.nordicsemi.no/bitbucket/scm/drgn
    - name: memfault
      url-base: https://github.com/memfault
    - name: ant-nrfconnect
      url-base: https://github.com/ant-nrfconnect

  # If not otherwise specified, the projects below should be obtained
  # from the ncs remote.
  defaults:
    remote: ncs

  group-filter: [-homekit, -nrf-802154, -dragoon, -find-my, -doc-internal]

  # "projects" is a list of git repositories which make up the NCS
  # source code.
  #
  # For 'userdata' fields in the projects area, please refer to:
  # https://developer.nordicsemi.com/nRF_Connect_SDK/doc/latest/nrf/dm_code_base.html
  projects:

    # The Zephyr RTOS fork in the NCS, along with the subset of its
    # modules which NCS imports directly.
    #
    # https://developer.nordicsemi.com/nRF_Connect_SDK/doc/latest/zephyr/introduction/index.html
    # https://developer.nordicsemi.com/nRF_Connect_SDK/doc/latest/zephyr/guides/modules.html
    - name: zephyr
      repo-path: sdk-zephyr-next
      revision: aa27dbbb6fe16d5a589a3b7f9707dc8e3815b760
      import:
        # In addition to the zephyr repository itself, NCS also
        # imports the contents of zephyr/west.yml at the above
        # revision. Only the projects explicitly named in the
        # following allowlist are imported.
        #
        # Note that the zephyr west extensions (like 'build', 'flash',
        # 'debug', etc.) are automatically provided by this import, so
        # there's no need to add a redundant west-commands: key for
        # the zephyr project.
        #
        # Please keep this list sorted alphabetically.
        name-allowlist:
          - TraceRecorderSource
          - canopennode
          - chre
          - cmsis
          - coremark
          - edtt
          - fatfs
          - fff
          - hal_st
          - liblc3codec
          - libmetal
          - littlefs
          - loramac-node
          - lvgl
          - lz4
          - mipi-sys-t
          - nanopb
          - net-tools
          - nrf_hw_models
          - open-amp
          - picolibc
          - psa-arch-tests
          - sdk-hal_nordic-next
          - segger
          - tinycbor
          - tinycrypt
          - tf-m-tests
          - uoscore-uedhoc
          - zcbor
          - zscilib

    # NCS repositories.
    #
    # Some of these are also Zephyr modules which have NCS-specific
    # changes.
    - name: sdk-hostap
      path: modules/lib/hostap
      revision: c1f1e0593d5bde73ba5d512b44fb765472829574
    - name: mcuboot
      repo-path: sdk-mcuboot
      revision: 9d2f9b5742c5cabcb87b7f7f22ff5269b13403bf
      path: bootloader/mcuboot
    - name: mbedtls-nrf
      path: mbedtls
      repo-path: sdk-mbedtls
      revision: v3.1.0-ncs2
    - name: nrfxlib
      repo-path: sdk-nrfxlib-next
      path: nrfxlib
      revision: 5d7eaac546703af8d214383b2b002784d990edcf
    - name: doc-internal
      repo-path: doc-internal
      path: modules/doc-internal
      revision: 7e505f7da3da55bf8163a225556def5b0254745b
      groups:
      - doc-internal
    - name: ic-next
      repo-path: sdk-ic-next
      path: modules/ic-next
      revision: 62c405fb8635eab2935b8de335bc7bc53f0d2c3d
    - name: sdk-secdom
      revision: f82680daeb73cc7008393ea927a72bc3dc2da185
      path: core_fw/secdom
    - name: nrf-regtool
      revision: 72a88481d00d772585bd7a7c325916acc645e5c1
      path: modules/lib/nrf-regtool
    - name: nrfs
      path: modules/lib/nrfs
      revision: 8720c48205798282ddccf8f0b3e7093d28fca9ea
    - name: sdk-sysctrl
      revision: 6c7e4a870b188d4b93606a012339ca18a9cf3521
      path: core_fw/sysctrl
    - name: trusted-firmware-m
      repo-path: sdk-trusted-firmware-m
      path: modules/tee/tf-m/trusted-firmware-m
      revision: 1b7ee9d3cb09cb0081f49c3d20220cdf7d5f7b3c
    - name: matter
      repo-path: sdk-connectedhomeip-next
      path: modules/lib/matter
      revision: 39436db7a196caa3c41e348cc5aa558b239c6c3a
      submodules:
        - name: nlio
          path: third_party/nlio/repo
        - name: nlassert
          path: third_party/nlassert/repo
        - name: nlunit-test
          path: third_party/nlunit-test/repo
        - name: pigweed
          path: third_party/pigweed/repo
    - name: nrf-802154
      repo-path: sdk-nrf-802154
      path: nrf-802154
      revision: c601469f41ecc4546cd1feb04d49b611cc872161
      groups:
        - nrf-802154
    - name: dragoon
      # Only for internal Nordic development
      repo-path: dragoon.git
      remote: dragoon
      revision: b093384fc4663a2da582811314e13db2a52c81ac
      submodules: true
      groups:
        - dragoon
    - name: cjson
      repo-path: sdk-cjson
      path: modules/lib/cjson
      revision: c6af068b7f05207b28d68880740e4b9ec1e4b50a
    - name: homekit
      repo-path: sdk-homekit
      revision: 4a941dc22638852f841aa9644aaeb72f9c95cfea
      groups:
        - homekit
    - name: find-my
      repo-path: sdk-find-my
      revision: 219987daaac52ff0799ca29aaf7aff5f1276f045
      groups:
        - find-my
    - name: azure-sdk-for-c
      repo-path: azure-sdk-for-c
      path: modules/lib/azure-sdk-for-c
      revision: 308c171cb4b5eed266649012a68406487ec81fb2
    - name: suit-processor
      revision: c2b3d445f82be95a56b18df5269ed801abb70f50
      path: modules/lib/suit-processor
    - name: suit-generator
      revision: fd39ab8825d26d6365f604e5c942627228873b34
      path: modules/lib/suit-generator
    # Other third-party repositories.
    - name: cmock
      path: test/cmock
      submodules: true
      revision: f65066f15d8248e6dcb778efb8739904a4512087
      remote: throwtheswitch
    - name: memfault-firmware-sdk
      path: modules/lib/memfault-firmware-sdk
      revision: 0.35.0
      remote: memfault
    - name: cirrus
      repo-path: sdk-mcu-drivers
      path: modules/hal/cirrus-logic
      revision: 9f6b3812237fbb0d4157ba3584c13f1644fcbe3a
    - name: openthread
      repo-path: sdk-openthread
      path: modules/lib/openthread
      revision: 488ee63b4c170cb5d1789258a69f27aba19c3720

  # West-related configuration for the nrf repository.
  self:
    # This repository should be cloned to ncs/nrf.
    path: nrf
    # This line configures west extensions.
    west-commands: scripts/west-commands.yml
```
