## CMakeLists.txt
```
#
# Copyright (c) 2023 Nordic Semiconductor ASA. All Rights Reserved.
#
# The information contained herein is confidential property of Nordic Semiconductor ASA.
# The use, copying, transfer or disclosure of such information is prohibited except by
# express written agreement with Nordic Semiconductor ASA.
#

cmake_minimum_required(VERSION 3.8.2)

find_package(Zephyr REQUIRED HINTS $ENV{ZEPHYR_BASE})
project(modem_trace)

target_sources(app PRIVATE src/main.c)
```

## prj.conf
```kconfig
#
# Copyright (c) 2023 Nordic Semiconductor ASA
#
# SPDX-License-Identifier: LicenseRef-Nordic-5-Clause
#
CONFIG_ZTEST=y
CONFIG_ZTEST_NEW_API=y
CONFIG_ASSERT=y
CONFIG_RESET_ON_FATAL_ERROR=n

CONFIG_NRF_MODEM_LIB=y
CONFIG_NRF_MODEM_LIB_SYS_INIT=n

CONFIG_REBOOT=y

# Modem trace
CONFIG_NRF_MODEM_LIB_TRACE=y
CONFIG_NRF_MODEM_LIB_TRACE_BACKEND_FLASH=y

#increase trace write speed
CONFIG_FCB_ALLOW_FIXED_ENDMARKER=y
CONFIG_NRF_MODEM_TRACE_FLASH_NOSPACE_SIGNAL=y

# Logging
CONFIG_LOG=y
CONFIG_NRF_MODEM_LIB_LOG_LEVEL_ERR=y
#CONFIG_NRF_MODEM_LOG=y
CONFIG_FLASH_LOG_LEVEL_DBG=y
CONFIG_MODEM_TRACE_BACKEND_LOG_LEVEL_DBG=y


CONFIG_TFM_LOG_LEVEL_SILENCE=n
CONFIG_TFM_SECURE_UART0=y
CONFIG_TFM_SECURE_UART_SHARE_INSTANCE=y

# Enable PM_DEVICE to have pinctrl called on deinit
CONFIG_PM_DEVICE=y
```

## boards/nrf9160dk_nrf9160_ns.conf
```kconfig
#
# Copyright (c) 2023 Nordic Semiconductor ASA
#
# SPDX-License-Identifier: LicenseRef-Nordic-5-Clause
#

CONFIG_SPI=y
CONFIG_SPI_NOR=y
CONFIG_SPI_NOR_SFDP_DEVICETREE=y

CONFIG_PM_OVERRIDE_EXTERNAL_DRIVER_CHECK=y
CONFIG_PM_PARTITION_SIZE_MODEM_TRACE=0x100000
```

## src/main.c
```c
/*
 * Copyright (c) 2023 Nordic Semiconductor ASA
 *
 * SPDX-License-Identifier: LicenseRef-Nordic-5-Clause
 */

#include <zephyr/ztest.h>
#include <stdbool.h>
#include <string.h>
#include <zephyr/kernel.h>
#include <zephyr/sys/reboot.h>

#include <time.h>
#include <stdlib.h>

#include <nrf_modem_trace.h>
#include <modem/trace_backend.h>

extern struct trace_backend trace_backend;

static int __noinit has_booted;

#define BUF_SIZE CONFIG_NRF_MODEM_LIB_TRACE_BACKEND_FLASH_BUF_SIZE
static uint8_t buf_write[2*BUF_SIZE];
static uint8_t buf_read[2*BUF_SIZE];

static int nrf_modem_trace_processed_test_cb(size_t len)
{
	return 0;
}

static void *suite_setup(void)
{
	int err;

	srand(time(NULL));

	err = trace_backend.init(nrf_modem_trace_processed_test_cb);
	zassert_ok(err);

	/* Be explicit as has_booted is __noinit */
	if (has_booted != true) {
		printk("Preparing data\n");
		for (int i = 0; i < 100; i++) {
			err = trace_backend.write(&buf_write[i], BUF_SIZE);
			zassert_equal(BUF_SIZE, err,
				      "write failed on iteration %d, err %d", i, err);
		}

		err = trace_backend.write(buf_write, 50);
		zassert_equal(50, err, "write failed err %d", err);

		has_booted = true;
		sys_reboot(SYS_REBOOT_WARM);
	}

	return NULL;
}

ZTEST(trace_flash_boot, test_trace_flash_write_read_warm)
{
	int ret;

	for (int i = 0; i < 100; i++) {
		ret = trace_backend.read((void *)buf_read, sizeof(buf_read));
		zassert_equal(BUF_SIZE, ret, "read failed on iteration %d, err %d", i, ret);
		zassert_mem_equal(&buf_write[i], buf_read, ret);
	}

	ret = trace_backend.read((void *)buf_read, sizeof(buf_read));
	zassert_equal(50, ret, "read failed, err %d", ret);
	zassert_mem_equal(buf_write, buf_read, ret);

	ret = trace_backend.read((void *)buf_read, sizeof(buf_read));
	zassert_equal(-ENODATA, ret, "read unexpected return %d", ret);

	/* Write new data */
	for (int i = 0; i < 100; i++) {
		ret = trace_backend.write(&buf_write[i], BUF_SIZE);
		zassert_equal(BUF_SIZE, ret, "write failed on iteration %d, err %d", i, ret);
	}
}

ZTEST_SUITE(trace_flash_boot, NULL, suite_setup, NULL, NULL, NULL);
```
