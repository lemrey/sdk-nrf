## CMakeLists.txt
```
#
# Copyright (c) 2023 Nordic Semiconductor
#
# SPDX-License-Identifier: LicenseRef-Nordic-5-Clause
#

cmake_minimum_required(VERSION 3.20.0)

find_package(Zephyr REQUIRED HINTS $ENV{ZEPHYR_BASE})
project(nRF92_devel_app)

target_sources(app PRIVATE src/main.c)
```

## prj.conf
```kconfig
CONFIG_ZTEST=y
CONFIG_ZTEST_NEW_API=y

CONFIG_TEST_LOGGING_DEFAULTS=n
CONFIG_NULL_POINTER_EXCEPTION_DETECTION_NONE=y

CONFIG_HEAP_MEM_POOL_SIZE=1024
CONFIG_MAIN_STACK_SIZE=4096

CONFIG_NEWLIB_LIBC=y

CONFIG_DEBUG_OPTIMIZATIONS=y
CONFIG_RESET_ON_FATAL_ERROR=n

CONFIG_NRF_MODEM_LIB=y

CONFIG_NETWORKING=y
CONFIG_NET_SOCKETS=y
CONFIG_NET_SOCKETS_POSIX_NAMES=y
CONFIG_NET_NATIVE=n
```

## uart_logging.conf
```kconfig
#
# Copyright (c) 2022 Nordic Semiconductor ASA
#
# SPDX-License-Identifier: LicenseRef-Nordic-4-Clause
#

CONFIG_LOG=y
CONFIG_LOG_PRINTK=y
CONFIG_SERIAL=y
CONFIG_CONSOLE=y
CONFIG_UART_CONSOLE=y
CONFIG_LOG_BACKEND_UART=y

CONFIG_LOG_BUFFER_SIZE=8192

CONFIG_LOG_BACKEND_FORMAT_TIMESTAMP=n
CONFIG_LOG_TRACE_SHORT_TIMESTAMP=n
CONFIG_LOG_FUNC_NAME_PREFIX_DBG=n
```

## src/main.c
```c
/*
 * Copyright (c) 2023 Nordic Semiconductor ASA
 *
 * SPDX-License-Identifier: LicenseRef-Nordic-5-Clause
 */

#include <zephyr/ztest.h>
#include <modem/nrf_modem_lib.h>
#include <nrf_modem_at.h>

static void *suite_setup(void)
{
	int err;

	err = nrf_modem_lib_init();
	zassert_ok(err, "Unable to initialize modem, err %d", err);

	return NULL;
}

static void suite_teardown(void *f)
{
	int err;

	err = nrf_modem_lib_shutdown();
	zassert_ok(err, "Unable to shutdown modem, err %d", err);
}

ZTEST(nrf92_devel_app, test_nrf_modem_lib_send_at_cmds)
{
	int err;
	char buf[32];

	for (int i = 0; i < 5; ++i) {
		err = nrf_modem_at_cmd(buf, sizeof(buf), "AT");
		zassert_ok(err, "Error when sending \"AT\", err %d", err);
	}

	err = nrf_modem_at_cmd(buf, sizeof(buf), "AT+CGMR");
	zassert_ok(err, "Error when sending \"AT+CGMR\", err %d", err);
	
	/* Ensure we don't print from outside the buffer. */
	buf[sizeof(buf)-1] = '\0';
	printk("\"AT+CGMR\" response: %s", (char *)buf);
}

ZTEST(nrf92_devel_app, test_nrf_modem_lib_reinitialize)
{
	int err;

	k_msleep(50);

	err = nrf_modem_lib_shutdown();
	zassert_ok(err, "Failed to shutdown modem, err %d", err);

	printk("Shutdown modem complete");

	k_msleep(50);

	err = nrf_modem_lib_init();
	zassert_ok(err, "Unable to reinitialize modem, err %d", err);

	printk("Modem reinitialized");
}

ZTEST_SUITE(nrf92_devel_app, NULL, suite_setup, NULL, NULL, suite_teardown);
```
