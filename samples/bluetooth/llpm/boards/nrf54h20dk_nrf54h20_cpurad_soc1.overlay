/*
 * Copyright (c) 2023 Nordic Semiconductor ASA
 *
 * SPDX-License-Identifier: LicenseRef-Nordic-5-Clause
 */

#include <common/nordic_nrf_next/nrfx_ram3x_dma.dtsi>

/ {
	chosen {
		zephyr,console = &uart135;
	};
};

&ram3x_cpurad {
	status = "okay";
};

&uart135 {
	status = "okay";
	memory-regions = <&ram3x_cpurad>;
};
