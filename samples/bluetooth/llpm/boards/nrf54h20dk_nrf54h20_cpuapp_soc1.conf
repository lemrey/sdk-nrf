## samples/bluetooth/llpm/boards/nrf54h20dk_nrf54h20_cpuapp_soc1.conf
```kconfig
#
# Copyright (c) 2023 Nordic Semiconductor ASA
#
# SPDX-License-Identifier: LicenseRef-Nordic-5-Clause
#

CONFIG_SERIAL=y
CONFIG_CONSOLE=y
CONFIG_UART_CONSOLE=y

CONFIG_MBOX=y
CONFIG_MBOX_NRFX_IDS=y

# BT CTLR is run on Radio Core, it must be set in hci_rpmsg image config.
CONFIG_BT_CTLR_SDC_LLPM=n
```

## samples/bluetooth/llpm/sample.yaml
```yaml
sample:
  description: Buetooth Low Energy LLPM sample
  name: BLE LLPM
tests:
  sample.bluetooth.llpm:
    build_only: true
    integration_platforms:
      - nrf52dk_nrf52832
      - nrf52840dk_nrf52840
      - nrf52840dongle_nrf52840
      - nrf54h20dk_nrf54h20_cpuapp@soc1
      - nrf54h20dk_nrf54h20_cpurad@soc1
    platform_allow: >
      nrf52dk_nrf52832
      nrf52840dk_nrf52840
      nrf52840dongle_nrf52840
      nrf54h20dk_nrf54h20_cpuapp@soc1
      nrf54h20dk_nrf54h20_cpurad@soc1
    tags: bluetooth ci_build
```

## samples/bluetooth/peripheral_hids_keyboard/boards/nrf54l15dk_nrf54l15_cpuapp_soc1.conf
```kconfig
#
# Copyright (c) 2023 Nordic Semiconductor
#
# SPDX-License-Identifier: LicenseRef-Nordic-5-Clause
#

CONFIG_DK_LIBRARY_BUTTON_NO_ISR=y
```

## samples/bluetooth/peripheral_rscs/boards/nrf54h20dk_nrf54h20_cpuapp_soc1.conf
```kconfig
#
# Copyright (c) 2023 Nordic Semiconductor ASA
#
# SPDX-License-Identifier: LicenseRef-Nordic-5-Clause
#

CONFIG_SERIAL=y
CONFIG_CONSOLE=y
CONFIG_UART_CONSOLE=y

CONFIG_MBOX=y
CONFIG_IPC_SERVICE=y
CONFIG_IPC_SERVICE_BACKEND_RPMSG=y
CONFIG_MBOX_NRFX_IDS=y
```

## samples/bluetooth/peripheral_rscs/sample.yaml
```yaml
sample:
  description: Bluetooth Low Energy Running Speed and Cadence Service sample
  name: Bluetooth LE RSCS sample
tests:
  sample.bluetooth.peripheral_rscs:
    build_only: true
    integration_platforms:
      - nrf52dk_nrf52832
      - nrf52840dk_nrf52840
      - nrf52833dk_nrf52833
      - nrf5340dk_nrf5340_cpuapp
      - nrf5340dk_nrf5340_cpuapp_ns
      - nrf54h20dk_nrf54h20_cpuapp@soc1
    platform_allow: nrf52dk_nrf52832 nrf52840dk_nrf52840 nrf52833dk_nrf52833 nrf5340dk_nrf5340_cpuapp
      nrf5340dk_nrf5340_cpuapp_ns nrf54h20dk_nrf54h20_cpuapp@soc1
    tags: bluetooth ci_build
```

## samples/bluetooth/peripheral_uart/boards/nrf54h20dk_nrf54h20_cpuapp_soc1.conf
```kconfig
#
# Copyright (c) 2023 Nordic Semiconductor
#
# SPDX-License-Identifier: LicenseRef-Nordic-5-Clause
#

# Enable the UART driver
CONFIG_NRFX_UARTE0=n

# NRFX UART driver does not support asynchronous RX yet.
# Temporary, use interrupt driven UART with asyc adapter to fit API.
CONFIG_UART_136_INTERRUPT_DRIVEN=y
CONFIG_BT_NUS_UART_ASYNC_ADAPTER=y
CONFIG_UART_INTERRUPT_DRIVEN=y

CONFIG_MBOX=y
CONFIG_IPC_SERVICE=y
CONFIG_IPC_SERVICE_BACKEND_RPMSG=y
CONFIG_MBOX_NRFX_IDS=y

CONFIG_NRF_REGTOOL_TOML_CONFIG_FILES="uicr/nrf54h20dk_nrf54h20_cpuapp.toml"
```

## samples/bluetooth/throughput/boards/nrf5340dk_nrf5340_cpuapp.conf
```kconfig
#
# Copyright (c) 2018 Nordic Semiconductor
#
# SPDX-License-Identifier: LicenseRef-Nordic-5-Clause
#
CONFIG_NCS_SAMPLES_DEFAULTS=n

CONFIG_LOG_MODE_MINIMAL=y
```

## samples/bluetooth/throughput/boards/nrf54h20dk_nrf54h20_cpuapp.conf
```kconfig
#
# Copyright (c) 2023 Nordic Semiconductor
#
# SPDX-License-Identifier: LicenseRef-Nordic-5-Clause
#

CONFIG_SERIAL=y
CONFIG_CONSOLE=y
CONFIG_UART_CONSOLE=y

CONFIG_HEAP_MEM_POOL_SIZE=4096

CONFIG_MBOX=y
CONFIG_IPC_SERVICE=y
CONFIG_IPC_SERVICE_BACKEND_RPMSG=y
CONFIG_MBOX_NRFX_IDS=y

CONFIG_LOG_MODE_IMMEDIATE=y
```

## samples/caf/boards/nrf54h20dk_nrf54h20_cpuapp_soc1.conf
```kconfig
CONFIG_SERIAL=y
CONFIG_LED_PWM=n
CONFIG_GPIO=y
CONFIG_LED_GPIO=y
CONFIG_CONSOLE=y
CONFIG_UART_CONSOLE=y
```

## samples/caf_sensor_manager/remote/boards/nrf54fpga_nrf5420soc1_cpuppr.conf
```kconfig
#
# Copyright (c) 2022 Nordic Semiconductor ASA
#
# SPDX-License-Identifier: LicenseRef-Nordic-5-Clause
#
################################################################################
CONFIG_LOG=n
CONFIG_ASSERT=n

CONFIG_BOOT_BANNER=n
CONFIG_PRINTK=y
CONFIG_CONSOLE=y
CONFIG_SERIAL=y
CONFIG_EARLY_CONSOLE=y
CONFIG_HEAP_MEM_POOL_SIZE=512

CONFIG_MBOX_NRFX_IDS=y
CONFIG_SIZE_OPTIMIZATIONS=y

# Higher timouts are required.
CONFIG_EVENT_MANAGER_PROXY_BIND_TIMEOUT_MS=1000
CONFIG_APP_SENSOR_MANAGER_REMOTE_CORE_INITIALIZATION_TIMEOUT=5000
```

## samples/crypto/aes_ctr/boards/nrf54l15dk_nrf54l15_cpuapp.conf
```kconfig
# Use Cracen crypto driver
CONFIG_PSA_CRYPTO_DRIVER_CRACEN=y
CONFIG_CRACEN=y
CONFIG_CRACEN_PRNG=y
CONFIG_NRF_KMU=y
CONFIG_MBEDTLS_PSA_CRYPTO_EXTERNAL_RNG=y
```

## samples/crypto/ecjpake/boards/nrf54l15dk_nrf54l15_cpuapp.conf
```kconfig
CONFIG_PSA_CRYPTO_DRIVER_OBERON=n
CONFIG_PSA_CRYPTO_DRIVER_CRACEN=y

CONFIG_CRACEN=y
CONFIG_LIB_KMU=y
```

## samples/crypto/hkdf/boards/nrf54h20dk_nrf54h20_cpuapp_soc1.conf
```kconfig
# Getting UART
CONFIG_SERIAL=y
CONFIG_UART_CONSOLE=y

# Use Oberon backend
CONFIG_PSA_CRYPTO_DRIVER_OBERON=y
CONFIG_PSA_CRYPTO_DRIVER_CC3XX=n

# Get Fake Entropy
CONFIG_ENTROPY_TEST_PRNG=y
```

## samples/crypto/hkdf/boards/nrf54l15dk_nrf54l15_cpuapp.conf
```kconfig
CONFIG_PSA_CRYPTO_DRIVER_OBERON=n
CONFIG_PSA_CRYPTO_DRIVER_CRACEN=y
CONFIG_CRACEN=y

CONFIG_MBEDTLS_PK_PARSE_C=y

CONFIG_LIB_KMU=y
```

## samples/crypto/hmac/sample.yaml
```yaml
sample:
  description: |
    This app provides an example of performing HMAC signing and verification
    using the SHA256 hashing algorithm decryption using AES CBC mode
  name: HMAC example
tests:
  sample.hmac:
    tags: introduction psa cc3xx
    platform_allow: >
        nrf5340dk_nrf5340_cpuapp_ns nrf5340dk_nrf5340_cpuapp
        nrf9160dk_nrf9160_ns nrf9160dk_nrf9160 nrf52840dk_nrf52840
        nrf54h20dk_nrf54h20_cpuapp@soc1 nrf54l15dk_nrf54l15_cpuapp@soc1
    harness: console
    harness_config:
      type: multi_line
      regex:
        - ".*Example finished successfully!.*"
    integration_platforms:
      - nrf5340dk_nrf5340_cpuapp_ns
      - nrf5340dk_nrf5340_cpuapp
      - nrf9160dk_nrf9160_ns
      - nrf9160dk_nrf9160
      - nrf52840dk_nrf52840
      - nrf54l15dk_nrf54l15_cpuapp@soc1
      - nrf54h20dk_nrf54h20_cpuapp@soc1
```

## samples/crypto/persistent_key_usage/boards/nrf54l15dk_nrf54l15_cpuapp.conf
```kconfig
# Using SW crypto accelerator
CONFIG_PSA_CRYPTO_DRIVER_OBERON=y
CONFIG_PSA_CRYPTO_DRIVER_CRACEN=n
# Still need Cracen to get entropy
CONFIG_CRACEN=y

# Note that NVS is only one of the options to enable persistent storage of keys
# using the settings subsystem.
CONFIG_FLASH=y
CONFIG_FLASH_PAGE_LAYOUT=y
CONFIG_FLASH_MAP=y
CONFIG_NVS=y
CONFIG_SETTINGS=y

# Comment out for more detailed NVS logging
CONFIG_NVS_LOG_LEVEL_ERR=y
```

## samples/crypto/rsa/boards/nrf54l15dk_nrf54l15_cpuapp.conf
```kconfig
# Use Cracen crypto driver
CONFIG_PSA_CRYPTO_DRIVER_CRACEN=y
CONFIG_CRACEN=y
CONFIG_CRACEN_PRNG=y
CONFIG_LIB_KMU=y
```

## samples/crypto/sha256/boards/nrf54l15dk_nrf54l15_cpuapp.conf
```kconfig
CONFIG_PSA_CRYPTO_DRIVER_OBERON=y
CONFIG_PSA_CRYPTO_DRIVER_CRACEN=n
CONFIG_CRACEN=y

CONFIG_LIB_KMU=y
```

## samples/event_manager_proxy/remote/boards/nrf54h20dk_nrf54h20_cpuppr_soc1_icmsg.conf
```kconfig
#
# Copyright (c) 2022 Nordic Semiconductor ASA
#
# SPDX-License-Identifier: LicenseRef-Nordic-5-Clause
#
################################################################################
CONFIG_LOG=y
CONFIG_LOG_MODE_MINIMAL=y
CONFIG_ASSERT=n
CONFIG_LOG_BACKEND_UART=n

CONFIG_BOOT_BANNER=n
CONFIG_PRINTK=y
CONFIG_CONSOLE=y
CONFIG_SERIAL=y
CONFIG_EARLY_CONSOLE=y
CONFIG_HEAP_MEM_POOL_SIZE=1024

CONFIG_MBOX_NRFX_IDS=y
CONFIG_SIZE_OPTIMIZATIONS=y

# Higher timouts are required.
CONFIG_EVENT_MANAGER_PROXY_BIND_TIMEOUT_MS=4000

# Slow down the sensor simulation
CONFIG_APP_MODULE_SENSOR_SIMULATED_INTERVAL=5000
```

## samples/ipc/ipc_service/boards/nrf9230dk_nrf9230_cpuapp_rad.conf
```kconfig
#
# Copyright (c) 2023 Nordic Semiconductor ASA
#
# SPDX-License-Identifier: LicenseRef-Nordic-5-Clause
#

CONFIG_MBOX_NRFX_IDS=y
CONFIG_APP_REMOTE_BOARD="nrf9230dk_nrf9230_cpurad"

CONFIG_APP_IPC_SERVICE_SEND_INTERVAL=900

CONFIG_UART_CONSOLE=y
CONFIG_CONSOLE=y
CONFIG_SERIAL=y
```

## samples/ipc/ipc_service/remote/boards/nrf54h20dk_nrf54h20_cpuapp_ppr.conf
```kconfig
#
# Copyright (c) 2022 Nordic Semiconductor ASA
#
# SPDX-License-Identifier: LicenseRef-Nordic-5-Clause
#

CONFIG_LOG=y
CONFIG_LOG_MODE_MINIMAL=y
CONFIG_ASSERT=y

CONFIG_BOOT_BANNER=n
CONFIG_PRINTK=y
CONFIG_CONSOLE=y
CONFIG_SERIAL=y
CONFIG_UART_CONSOLE=y
CONFIG_EARLY_CONSOLE=y
CONFIG_HEAP_MEM_POOL_SIZE=512

CONFIG_MBOX_NRFX_IDS=y
CONFIG_SIZE_OPTIMIZATIONS=y

# Disable GPIO
CONFIG_GPIO=n

CONFIG_APP_IPC_SERVICE_SEND_INTERVAL=30

# Force spsc_pbuf to work without DCACHE support
CONFIG_SPSC_PBUF_CACHE_ALWAYS=n
CONFIG_SPSC_PBUF_CACHE_NEVER=y
```

## samples/ipc/ipc_service/remote/boards/nrf54h20dk_nrf54h20_cpuapp_rad.conf
```kconfig
#
# Copyright (c) 2022 Nordic Semiconductor ASA
#
# SPDX-License-Identifier: LicenseRef-Nordic-5-Clause
#

CONFIG_LOG=y
CONFIG_ASSERT=y

CONFIG_BOOT_BANNER=n
CONFIG_PRINTK=y
CONFIG_CONSOLE=y
CONFIG_SERIAL=y
CONFIG_UART_CONSOLE=y
CONFIG_EARLY_CONSOLE=y

CONFIG_MBOX_NRFX_IDS=y
CONFIG_PARTITION_MANAGER_ENABLED=n

CONFIG_APP_IPC_SERVICE_SEND_INTERVAL=5000000
```

## samples/ipc/ipc_service/remote/boards/nrf54h20dk_nrf54h20_cpurad_sys.conf
```kconfig
#
# Copyright (c) 2022 Nordic Semiconductor ASA
#
# SPDX-License-Identifier: LicenseRef-Nordic-5-Clause
#

CONFIG_LOG=y
CONFIG_LOG_MODE_MINIMAL=y
CONFIG_ASSERT=y

CONFIG_BOOT_BANNER=n
CONFIG_PRINTK=y
CONFIG_CONSOLE=y
CONFIG_SERIAL=y
CONFIG_UART_CONSOLE=y
CONFIG_EARLY_CONSOLE=y

CONFIG_MBOX_NRFX_IDS=y

CONFIG_NRF_REGTOOL_TOML_CONFIG_FILES="uicr/nrf54h20dk_nrf54h20_cpusys.toml"

CONFIG_APP_IPC_SERVICE_SEND_INTERVAL=4000000
```

## samples/ipc/ipc_service/remote/boards/nrf54h20dk_nrf54h20_cpusys.conf
```kconfig
#
# Copyright (c) 2022 Nordic Semiconductor ASA
#
# SPDX-License-Identifier: LicenseRef-Nordic-5-Clause
#

# Start GRTC instead of Secure Domain
CONFIG_NRF_GRTC_START_SYSCOUNTER=y
```
