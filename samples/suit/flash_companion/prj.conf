## CMakeLists.txt
```
#
# Copyright (c) 2024 Nordic Semiconductor ASA
#
# SPDX-License-Identifier: LicenseRef-Nordic-5-Clause
#

cmake_minimum_required(VERSION 3.20.0)

set(EXTRA_DTC_OVERLAY_FILE "${CMAKE_SOURCE_DIR}/app.overlay")

find_package(Zephyr REQUIRED HINTS $ENV{ZEPHYR_BASE})
project(flash_companion)

target_sources(app PRIVATE src/main.c)
```

## prj.conf
```kconfig
#
# Copyright (c) 2024 Nordic Semiconductor ASA
#
# SPDX-License-Identifier: LicenseRef-Nordic-5-Clause
#

# Minimal scheduler configuration
CONFIG_NUM_PREEMPT_PRIORITIES=0
CONFIG_MULTITHREADING=y
CONFIG_NUM_COOP_PRIORITIES=16
CONFIG_NUM_METAIRQ_PRIORITIES=0
CONFIG_SCHED_DUMB=y
CONFIG_WAITQ_DUMB=y

# Enable peripherals needed by the flash companion firmware
CONFIG_GPIO=y
CONFIG_PINCTRL=y
CONFIG_FLASH=y

# Disable power management
CONFIG_PM=n

# Disable unneeded interrupt features
CONFIG_DYNAMIC_INTERRUPTS=n
CONFIG_IRQ_OFFLOAD=n

# Disable memory protection
CONFIG_THREAD_STACK_INFO=n
CONFIG_THREAD_CUSTOM_DATA=n

# Disable unneeded ARM core functionality
CONFIG_ARM_MPU=n
CONFIG_FPU=n

# Disable boot banner
CONFIG_BOOT_BANNER=n
CONFIG_BOOT_DELAY=0

# Disable serial communication
CONFIG_CONSOLE=n
CONFIG_UART_CONSOLE=n
CONFIG_STDOUT_CONSOLE=n
CONFIG_PRINTK=n
CONFIG_EARLY_CONSOLE=n

# Build
CONFIG_SIZE_OPTIMIZATIONS=y

# Enable external memory service
CONFIG_SSF_EXTMEM_SERVICE_ENABLED=y

# Link against zephyr,code-partition
CONFIG_USE_DT_CODE_PARTITION=y
```

## app.overlay
```dts
/*
 * Copyright (c) 2024 Nordic Semiconductor ASA
 *
 * SPDX-License-Identifier: LicenseRef-Nordic-5-Clause
 */

/ {
	chosen {
		zephyr,code-partition = &companion_partition;
		nrf,tz-secure-image = &companion_partition;
	};
};

&ipc_to_cpusec {
	status = "okay";
};

&ipc_cpurad {
	status = "disabled";
};
```

## src/main.c
```c
/*
 * Copyright (c) 2024 Nordic Semiconductor ASA
 *
 * SPDX-License-Identifier: LicenseRef-Nordic-5-Clause
 */

#include <zephyr/kernel.h>
#include <extmem_remote.h>

int main(void)
{
	extmem_remote_init();
	return 0;
}
```
