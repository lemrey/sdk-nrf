/*
 * Copyright (c) 2023 Nordic Semiconductor ASA
 *
 * SPDX-License-Identifier: Apache-2.0
 */

&uart30 {
    current-speed = <1000000>;
    status = "okay";
};

 / {
    chosen {
        zephyr,ot-uart = &uart30;
    };
};
