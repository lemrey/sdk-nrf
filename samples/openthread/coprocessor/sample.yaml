## subsys/suit/storage/Kconfig
```kconfig
#
# Copyright (c) 2023 Nordic Semiconductor ASA
#
# SPDX-License-Identifier: LicenseRef-Nordic-5-Clause
#

menuconfig SUIT_STORAGE
	bool "Enable SUIT storage module"
	depends on ZCBOR
	depends on ZCBOR_CANONICAL
	depends on SUIT_MCI
	depends on SUIT_METADATA
	depends on SUIT_UTILS
	depends on FLASH

if SUIT_STORAGE

config SUIT_STORAGE_N_UPDATE_REGIONS
	int "Maximum number of memory regions, describing the update candidate"
	default 1
	help
	  The memory region may describe SUIT envelope as well as the SUIT cache.

config SUIT_STORAGE_N_ENVELOPES
	int "Number of envelopes, possible to store in SUIT storage"
	default 8 if SOC_NRF54H20
	default 5 if SOC_NRF52840
	default 5 if SOC_POSIX
	help
	  Since it is not supported to reserve more memory after the device
	  is deployed, use larger value than it is necessary.

	  For nRF54H20 the following envelopes may be defined:
	    - SecDom + SysCtlr: firmware
	    - SecDom + SysCtlr: recovery
	    - ROOT
	    - Radio: firmware
	    - Application: firmware
	    - Application: recovery
	    - Application: user data
	    - spare slot

	  For debug and test platforms (POSIX, nRF52840) the following envelopes may be defined:
	    - ROOT
	    - Application: firmware
	    - Application: recovery
	    - Application: user data
	    - spare slot

config SUIT_STORAGE_ENVELOPE_SIZE
	int "The maximum size of envelope that can be stored in a single SUIT storage slot"
	default 2048

config SUIT_STORAGE_CONFIG_SIZE
	int "The size of the SUIT configuration area, stored inside the SUIT storage partition"
	default 128

endif # SUIT_STORAGE
```

## subsys/suit/stream/Kconfig
```kconfig
#
# Copyright (c) 2023 Nordic Semiconductor ASA
#
# SPDX-License-Identifier: LicenseRef-Nordic-5-Clause
#

menuconfig SUIT_STREAM
        bool "Enable SUIT stream module"
        depends on SUIT_UTILS

if SUIT_STREAM

config SUIT_STREAM_SINK_CACHE
        bool "Enable SUIT cache sink"
        depends on SUIT_CACHE_RW

config SUIT_STREAM_SINK_MEMPTR
        bool "Enable memory pointer storage sink"
        depends on SUIT_MEMPTR_STORAGE

config SUIT_STREAM_SINK_MRAM
        bool "Enable NVM storage sink"
        depends on FLASH
        depends on SUIT_UTILS

config SUIT_STREAM_SINK_RAM
        bool "Enable RAM buffer sink"

menuconfig SUIT_STREAM_SINK_SDFW
  bool "Enable SDFW sink"
  depends on SOC_NRF54H20
  depends on !HW_REVISION_SOC1
  default y if IS_SECURE_DOMAIN_FW
  select PSA_WANT_ALG_SHA_512
  select SUIT_STREAM_SINK_DIGEST

if SUIT_STREAM_SINK_SDFW

config SUIT_SDFW_UPDATE_SIGNED_MANIFEST_OFFSET
  hex "Offset between start of the SDFW update candidate image and Signed Manifest section"
  default 0

config SUIT_SDFW_UPDATE_DIGEST_OFFSET
  hex "Offset between start of the SDFW update candidate image and SM.TBS.FW.DIGEST section"
  default 0x20

config SUIT_SDFW_UPDATE_PUBLIC_KEY_OFFSET
  hex "Offset between start of the SDFW update candidate image and Public Key section"
  default 0x100

config SUIT_SDFW_UPDATE_SIGNATURE_OFFSET
  hex "Offset between start of the SDFW update candidate image and Signature section"
  default 0x120

config SUIT_SDFW_UPDATE_FIRMWARE_OFFSET
  hex "Offset between start of the SDFW update candidate image and Firmware section"
  default 0x160

config SUIT_SDFW_UPDATE_MAX_SIZE
  hex "Maximum size of SDFW update"
  range 0x00000080 0x000FD000
  default 0x000FD000
  help
    Range is based on documentation of register UROT.SM.TBS.LAYOUT.USLOT.MAX

endif # SUIT_STREAM_SINK_SDFW

config SUIT_STREAM_SINK_DIGEST
  bool "Enable digest sink"
  select PSA_WANT_ALG_SHA_256 if SOC_FAMILY_NRF

if SUIT_STREAM_SINK_DIGEST
  config SUIT_STREAM_SINK_DIGEST_CONTEXT_COUNT
  int "Maximum number of contexts"
  default 1
endif # SUIT_STREAM_SINK_DIGEST

config SUIT_STREAM_SOURCE_CACHE
  bool "Enable SUIT cache source"
  depends on SUIT_CACHE

config SUIT_STREAM_SOURCE_MEMPTR
  bool "Enable memory pointer storage source"

endif # SUIT_STREAM
```

## tests/dcache/singlecore/testcase.yaml
```yaml
tests:
  dcache.singlecore:
    platform_allow:
      nrf54h20dk_nrf54h20_cpuapp@soc1
    integration_platforms:
      - nrf54h20dk_nrf54h20_cpuapp@soc1
```

## tests/lib/at_cmd_hook/testcase.yaml
```yaml
tests:
  at_cmd_hook.functionality_test:
    platform_allow: nrf9160dk_nrf9160_ns
    integration_platforms:
      - nrf9160dk_nrf9160_ns
    tags: at_cmd_hook
```

## tests/lib/gcf_sms_lib/testcase.yaml
```yaml
tests:
  gcf_sms_lib.functionality_test:
    platform_allow: nrf9160dk_nrf9160_ns
    tags: gcf_sms_lib
```

## tests/lib/nrf_modem_lib/at_cmd_filter/testcase.yaml
```yaml
tests:
  nrf_modem_lib.at_filters:
    platform_allow: nrf9160dk_nrf9160_ns
    tags: nrf_modem_lib
```

## tests/lib/nrf_modem_lib/nrf92_devel_app/testcase.yaml
```yaml
common:
  tags: nrf_modem_lib
  build_only: true
tests:
  #
  # Default fpga build with no logging.
  #
  nrf_modem_lib.nrf92_devel_app.fpga:
    platform_allow: nrf9230dk_nrf9230_cpuapp
    integration_platforms:
      - nrf9230dk_nrf9230_cpuapp
    extra_configs:
      - CONFIG_EMULATOR_FPGA=y

  #
  # Logging with STM ETR dump to UART.
  #
  nrf_modem_lib.nrf92_devel_app.etr_dump_uart.fpga:
    platform_allow: nrf9230dk_nrf9230_cpuapp
    integration_platforms:
      - nrf9230dk_nrf9230_cpuapp
    extra_configs:
      - CONFIG_EMULATOR_FPGA=y
      - CONFIG_NRF_MODEM_LOG=y
      - CONFIG_NRF_MODEM_LIB_LOG_LEVEL_DBG=y
      - CONFIG_LOG_STM=y

  #
  # Logging with STM TPIU to external fido logger.
  #
  nrf_modem_lib.nrf92_devel_app.fido.fpga:
    platform_allow: nrf9230dk_nrf9230_cpuapp
    integration_platforms:
      - nrf9230dk_nrf9230_cpuapp
    extra_configs:
      - CONFIG_EMULATOR_FPGA=y
      - CONFIG_NRF_MODEM_LOG=y
      - CONFIG_NRF_MODEM_LIB_LOG_LEVEL_DBG=y
      - CONFIG_LOG=y
      - CONFIG_LOG_BACKEND_CORESIGHT_STM=y
      - CONFIG_LOG_BACKEND_CORESIGHT_STM_FIDO_COMPATIBLE=y

  #
  # Logging with application standard UART.
  #
  nrf_modem_lib.nrf92_devel_app.uart.fpga:
    platform_allow: nrf9230dk_nrf9230_cpuapp
    integration_platforms:
      - nrf9230dk_nrf9230_cpuapp
    extra_args: EXTRA_CONF_FILE=uart_logging.conf
                DTC_OVERLAY_FILE=serial_cpuapp.overlay
    extra_configs:
      - CONFIG_EMULATOR_FPGA=y
      - CONFIG_NRF_MODEM_LOG=y
      - CONFIG_NRF_MODEM_LIB_LOG_LEVEL_DBG=y
```

## tests/lib/nrf_modem_lib/trace_backends/flash/testcase.yaml
```yaml
tests:
  trace_backends.flash:
    platform_allow: nrf9160dk_nrf9160_ns
    integration_platforms:
      - nrf9160dk_nrf9160_ns
    tags: nrf_modem_lib modem_trace
```

## tests/lib/nrf_modem_lib/trace_backends/flash_reboot/testcase.yaml
```yaml
tests:
  trace_backends.flash_reboot:
    platform_allow: nrf9160dk_nrf9160_ns
    integration_platforms:
      - nrf9160dk_nrf9160_ns
    tags: nrf_modem_lib modem_trace
```

## tests/subsys/event_manager_proxy/boards/nrf54fpga_nrf5420soc1_cpuapp_icmsg.conf
```kconfig
#
# Copyright (c) 2022 Nordic Semiconductor ASA
#
# SPDX-License-Identifier: LicenseRef-Nordic-5-Clause
#

CONFIG_MBOX_NRFX_IDS=y
CONFIG_NRF_REGTOOL_TOML_CONFIG_FILES="uicr/nrf54fpga_nrf5420_cpuapp.toml"
CONFIG_ENTROPY_PRNG=y
CONFIG_EVENT_MANAGER_PROXY_BIND_TIMEOUT_MS=1000
```

## tests/subsys/event_manager_proxy/boards/nrf54h20dk_nrf54h20_cpuapp_soc1_icmsg.conf
```kconfig
#
# Copyright (c) 2022 Nordic Semiconductor ASA
#
# SPDX-License-Identifier: LicenseRef-Nordic-5-Clause
#

CONFIG_MBOX_NRFX_IDS=y
CONFIG_NRF_REGTOOL_TOML_CONFIG_FILES="uicr/nrf54h20dk_nrf54h20_cpuapp@soc1.toml"
CONFIG_ENTROPY_TEST_PRNG=y
CONFIG_EVENT_MANAGER_PROXY_BIND_TIMEOUT_MS=1000

CONFIG_SERIAL=y
CONFIG_CONSOLE=y
```

## tests/subsys/event_manager_proxy/testcase.yaml
```yaml
tests:
  event_manager_proxy.openamp:
    platform_allow: nrf5340dk_nrf5340_cpuapp
    integration_platforms:
      - nrf5340dk_nrf5340_cpuapp
    tags: event_manager_proxy
  event_manager_proxy.icmsg:
    extra_args: CONF_FILE=prj_icmsg.conf
    platform_allow: nrf5340dk_nrf5340_cpuapp
    integration_platforms:
      - nrf5340dk_nrf5340_cpuapp
    tags: event_manager_proxy
  event_manager_proxy.icmsg.nrf54h20.fpga:
    extra_args: CONF_FILE=prj_icmsg.conf
    platform_allow: nrf54h20dk_nrf54h20_cpuapp@soc1
    integration_platforms:
      - nrf54h20dk_nrf54h20_cpuapp@soc1
    tags: event_manager_proxy
    extra_args: CONF_FILE=prj_icmsg.conf remote_CONFIG_EMULATOR_FPGA=y
    extra_configs:
      - CONFIG_EMULATOR_FPGA=y
```

## tests/subsys/suit/cache/testcase.yaml
```yaml
tests:
  suit-platform.integration.suit_cache:
    platform_allow: nrf52840dk_nrf52840 native_posix native_posix_64
    tags: suit suit_cache
    integration_platforms:
      - nrf52840dk_nrf52840
      - native_posix

  suit-platform.integration.suit_cache.fpga:
    platform_allow: nrf54h20dk_nrf54h20_cpusec@soc1
    tags: suit suit_cache fpga
    timeout: 240
    extra_args: DTC_OVERLAY_FILE=boards/nrf54h20dk_nrf54h20_cpusec.overlay;systick.overlay
    extra_configs:
      - CONFIG_EMULATOR_FPGA=y
```

## tests/subsys/suit/cache_sink/testcase.yaml
```yaml
tests:
  suit-platform.integration.cache_sink:
    platform_allow: nrf54h20dk_nrf54h20_cpuapp@soc1 native_posix native_posix_64
    tags: suit suit_cache
    integration_platforms:
      - native_posix

  suit-platform.integration.cache_sink.fpga:
    extra_args: CONFIG_EMULATOR_FPGA=y
    platform_allow: nrf54h20dk_nrf54h20_cpuapp@soc1
    tags: suit suit_cache fpga
    timeout: 240
```
