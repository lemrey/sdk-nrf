## samples/openthread/coprocessor/sample.yaml
```yaml
sample:
  description: Test OpenThread Co-Processor
  name: OpenThread Co-Processor sample
tests:
  sample.openthread.coprocessor:
    build_only: true
    extra_args: OVERLAY_CONFIG=overlay-logging.conf;overlay-vendor_hook.conf
    integration_platforms:
      - nrf52840dk_nrf52840
      - nrf52833dk_nrf52833
      - nrf21540dk_nrf52840
    platform_allow: nrf52840dk_nrf52840 nrf52833dk_nrf52833 nrf21540dk_nrf52840
    tags: ci_build
  sample.openthread.coprocessor.usb:
    build_only: true
    extra_args: OVERLAY_CONFIG=overlay-usb.conf DTC_OVERLAY_FILE="usb.overlay"
    integration_platforms:
      - nrf52840dk_nrf52840
      - nrf52840dongle_nrf52840
      - nrf52833dk_nrf52833
      - nrf21540dk_nrf52840
    platform_allow: nrf52840dk_nrf52840 nrf52840dongle_nrf52840 nrf52833dk_nrf52833
      nrf21540dk_nrf52840
    tags: ci_build
  sample.openthread.coprocessor_nrf54:
    build_only: true
    integration_platforms:
      - nrf54l15dk_nrf54l15_cpuapp@soc1
    platform_allow: nrf54l15dk_nrf54l15_cpuapp@soc1
    tags: ci_build
```

## samples/wifi/shell/boards/nrf54h20dk_nrf54h20_cpuapp_soc1.conf
```kconfig
#
# Copyright (c) 2023 Nordic Semiconductor ASA
#
# SPDX-License-Identifier: LicenseRef-Nordic-5-Clause
#
CONFIG_IMPRIMATUR_ENABLED=n
CONFIG_WPA_SUPP_CRYPTO_PSA=y
CONFIG_WPA_SUPP_CRYPTO=n
#CONFIG_ENTROPY_CRACEN=y
CONFIG_TEST_RANDOM_GENERATOR=y
CONFIG_TIMER_RANDOM_GENERATOR=y

CONFIG_SERIAL=y
CONFIG_CONSOLE=y
CONFIG_UART_CONSOLE=y
CONFIG_LOG_BUFFER_SIZE=8192
CONFIG_SHELL_BACKEND_SERIAL=y

# Timestamp is currently broken
CONFIG_LOG_BACKEND_FORMAT_TIMESTAMP=n
CONFIG_LOG_TRACE_SHORT_TIMESTAMP=n
```

## samples/zigbee/shell/sample.yaml
```yaml
sample:
  description: Zigbee application that includes all Zigbee shell commands
  name: Zigbee application with Zigbee shell
tests:
  sample.zigbee.shell:
    build_only: true
    integration_platforms:
      - nrf52840dk_nrf52840
      - nrf52833dk_nrf52833
      - nrf5340dk_nrf5340_cpuapp
      - nrf21540dk_nrf52840
    platform_allow: nrf52840dk_nrf52840 nrf52833dk_nrf52833 nrf5340dk_nrf5340_cpuapp
      nrf21540dk_nrf52840
    tags: ci_build shell
  sample.zigbee.shell.usb:
    build_only: true
    integration_platforms:
      - nrf52840dk_nrf52840
      - nrf52833dk_nrf52833
      - nrf21540dk_nrf52840
      - nrf52840dongle_nrf52840
    extra_args:
      CONF_FILE=prj_usb.conf
      DTC_OVERLAY_FILE="app_usb.overlay;app.overlay"
    platform_allow: nrf52840dk_nrf52840 nrf52833dk_nrf52833 nrf21540dk_nrf52840
      nrf52840dongle_nrf52840
    tags: ci_build shell
  sample.zigbee.nrf5340dk_nrf5340_cpuapp.shell.usb:
    build_only: true
    integration_platforms:
      - nrf5340dk_nrf5340_cpuapp
    extra_args:
      CONF_FILE=prj_usb.conf
      EXTRA_CONF_FILE=boards/nrf5340dk_nrf5340_cpuapp_usb.conf
      DTC_OVERLAY_FILE="app_usb.overlay;app.overlay"
    platform_allow: nrf5340dk_nrf5340_cpuapp
    tags: ci_build shell
```

## subsys/caf/events/Kconfig.sensor_data_aggregator_event
```kconfig
#
# Copyright (c) 2023 Nordic Semiconductor
#
# SPDX-License-Identifier: LicenseRef-Nordic-5-Clause
#

config CAF_SENSOR_DATA_AGGREGATOR_EVENTS
	bool "Sensor data aggregator module events"
	help
	  Enable sensor data aggregator events.

config CAF_INIT_LOG_SENSOR_DATA_AGGREGATOR_EVENTS
	bool "Log sensor data aggregator events"
	depends on LOG
	depends on CAF_SENSOR_DATA_AGGREGATOR_EVENTS
	default y
	help
	  Log the sensor data aggregator events.
```

## subsys/mgmt/suitfu/Kconfig
```kconfig
#
# Copyright (c) 2023 Nordic Semiconductor ASA
#
# SPDX-License-Identifier: LicenseRef-Nordic-5-Clause
#

menu "SUIT-based Firmware Update Management"

config MGMT_SUITFU
	bool "Serial SUIT Firmware Update support"
	depends on MCUMGR
	# The IMG MGMT group is substituted, not extended by the SUIT variant
	depends on !MCUMGR_CMD_IMG_MGMT
	depends on SSF_SUIT_SERVICE_ENABLED
	depends on FLASH
	select MCUMGR_SMP_CBOR_MIN_DECODING_LEVEL_5

config MGMT_SUITFU_IMAGE_NUMBER
	int "Image number representing SUIT envelope"
	default 0

config MGMT_SUITFU_TRIGGER_UPDATE_RESET_DELAY_MS
	int "Delay between update trigger and the last firmware chunk, in ms"
	default 100
	help
	  The delay allows the application to send the SMP response before the update is triggered.

config MGMT_SUITFU_AUTO_REGISTER_HANDLERS
	bool "Automatically register SUIT Firmware Update handlers during boot"
	default y
	help
	  Use MCUMGR_HANDLER_DEFINE to automatically register SUIT Firmware
	  Update handlers during boot.

module=MGMT_SUITFU
module-dep=LOG
module-str=SUIT-based Firmware Update Management
source "${ZEPHYR_BASE}/subsys/logging/Kconfig.template.log_config"

endmenu
```

## subsys/suit/Kconfig
```kconfig
#
# Copyright (c) 2020 Nordic Semiconductor ASA
#
# SPDX-License-Identifier: LicenseRef-Nordic-5-Clause
#

menuconfig SUIT
	bool "Enable SUIT modules"

if SUIT

config SUIT_DFU
	bool "Enable SUIT DFU - the interface for SUIT for the user application"
	default y if !IS_SECURE_DOMAIN_FW && !ZTEST

choice SUIT_PLATFORM_VARIANT
	prompt "SUIT platform implementation variant"
	default SUIT_PLATFORM_VARIANT_SDFW if IS_SECURE_DOMAIN_FW
	default SUIT_PLATFORM_VARIANT_APP if !IS_SECURE_DOMAIN_FW && !ZTEST

config SUIT_PLATFORM_VARIANT_SDFW
	bool "Set SUIT platform variant to Secure domain"

config SUIT_PLATFORM_VARIANT_APP
	bool "Set SUIT platform variant to application domain"

endchoice # SUIT_PLATFORM_VARIANT

if SUIT_DFU

choice SUIT_DFU_CANDIDATE_PROCESSING_LEVEL
	prompt "Select the level of SUIT candidate processing inside the user application"

config SUIT_DFU_CANDIDATE_PROCESSING_MINIMAL
	bool "Application defaults for minimal SUIT candidate processing"
	help
		This configuration can be used to allow update using SUIT when no interpretation
		of the SUIT envelope is needed by the local domain apart from basic format checking.
		This is equivalent to a situation where it is known that none of the manifests
		(the top manifest nor its dependecies) contains a suit-payload-fetch sequence.
		The only role of the application core is store the SUIT candidate envelope
		followed by passing the control to the Secure Domain.
		If the application needs to additionally store detached payloads in DFU cache
		partitions, CONFIG_SUIT_CACHE must be set apart from this option.
	imply SUIT_ORCHESTRATOR_APP
	imply SUIT_ORCHESTRATOR_APP_CANDIDATE_PROCESSING
	imply SUIT_ENVELOPE_INFO
	imply SUIT_UTILS
	imply SUIT_METADATA
	imply SSF_SUIT_SERVICE_ENABLED
	imply SUIT_MPI_GENERATE

config SUIT_DFU_CANDIDATE_PROCESSING_NONE
	bool "Disable any processing of the SUIT candidate envelope"
	help
		If this configuration is used no processing of the SUIT envelope will be performed.
		It will not be possible to start the update from inside the application using the
		SUIT DFU API.
		In a general use case this Kconfig option will only be use for companion images
		used by the Secure Domain to fetch additional data with the use of the application
		core.
	imply SUIT_ORCHESTRATOR_APP
	imply SUIT_MPI_GENERATE

endchoice # SUIT_APP_ENVELOPE_PROCESSING_LEVEL

config SUIT_STREAMING_REQUESTS_FROM_SDFW_SUPPORT
	bool "Enable support for streaming requests coming from SDFW"
	help
		In some cases when the Secure Domain processes the SUIT manifests may need to fetch
		additional data from outside the device. As the Secure Domain does not have access
		to any transport it needs to communicate with an application (a "companion image")
		running on one of the local domains to fetch data.
		Setting this Kconfig option will enable all the modules needed for
		such a local domain application.
		The implementer of this application needs to initialize the needed subsystems
		using suit_dfu_initialize and register transports as fetch sources.
	imply SUIT_ORCHESTRATOR_APP
	imply SUIT_UTILS
	imply SUIT_METADATA
	imply SSF_SUIT_SERVICE_ENABLED
	imply SUIT_STREAM_FETCH_SOURCE_MGR
	imply SUIT_STREAM_SOURCE_IPC
	imply SUIT_STREAM
	imply SUIT_STREAM_IPC_PROVIDER

endif # SUIT_DFU

config SUIT_ENABLE_DEFAULTS_SDFW
	bool "SDFW SUIT defaults"
	default y if IS_SECURE_DOMAIN_FW
	imply SUIT_CRYPTO
	imply SUIT_DEVCONFIG
	imply SUIT_PLAT_CHECK_COMPONENT_COMPATIBILITY
	imply SUIT_PLAT_CHECK_CLASSES
	imply SUIT_AUTHENTICATE
	imply SUIT_DIGEST
	imply SUIT_DIGEST_CACHE
	imply SUIT_CHECK_IMAGE_MATCH
	imply SUIT_MCI
	imply SUIT_METADATA
	imply SUIT_ORCHESTRATOR
	imply SUIT_PLATFORM
	imply SUIT_STREAM
	imply SUIT_STREAM_SINK_MEMPTR
	imply SUIT_STREAM_SINK_FLASH
	imply SUIT_STREAM_SINK_DIGEST
	imply SUIT_STREAM_SOURCE_CACHE
	imply SUIT_STREAM_SOURCE_MEMPTR
	imply SUIT_STREAM_SOURCE_IPC
	imply SUIT_STREAM_IPC_REQUESTOR
	imply SUIT_MEMPTR_STORAGE
	imply SUIT_UTILS
	imply SUIT_CACHE
	imply SUIT_STORAGE
	imply SUIT_SINK_SELECTOR
	imply SUIT_EXECUTION_MODE

rsource "cache/Kconfig"
rsource "mci/Kconfig"
rsource "metadata/Kconfig"
rsource "storage/Kconfig"
rsource "orchestrator/Kconfig"
rsource "orchestrator_app/Kconfig"
rsource "memptr_storage/Kconfig"
rsource "platform/Kconfig"
rsource "stream/Kconfig"
rsource "utils/Kconfig"
rsource "envelope_info/Kconfig"
rsource "execution_mode/Kconfig"

# Configure SUIT_LOG_LEVEL
module = SUIT
module-str = Software Updates for Internet of Things
source "${ZEPHYR_BASE}/subsys/logging/Kconfig.template.log_config"

endif # SUIT
```

## subsys/suit/cache/Kconfig
```kconfig
#
# Copyright (c) 2023 Nordic Semiconductor ASA
#
# SPDX-License-Identifier: LicenseRef-Nordic-5-Clause
#

menuconfig SUIT_CACHE
	bool "Enable SUIT cache support library"
	depends on ZCBOR

if SUIT_CACHE

config SUIT_CACHE_MAX_CACHES
	int "The maximum number of caches that will be handled"
	range 1 16
	help
	  The maximum number of user-defined caches is limited to 15.
	  User defined cache partitions names start at index 1 as suit_cache_0 is predefined.
	  The default value is 8, and the minimum is 1.
	default 8

config APP_LINK_WITH_SUIT_CACHE_INTERFACE
	bool
	default y

config SUIT_CACHE_RW
	bool "Enable write mode for SUIT cache"
	depends on FLASH
	depends on SUIT_UTILS

config SUIT_MAX_URI_LENGTH
	int "The maximum number of charachters in uri used in fetch operations"
	range 1 512
	default 64
	depends on SUIT_CACHE_RW

endif # SUIT_CACHE
```

## subsys/suit/execution_mode/Kconfig
```kconfig
#
# Copyright (c) 2024 Nordic Semiconductor ASA
#
# SPDX-License-Identifier: LicenseRef-Nordic-5-Clause
#

menuconfig SUIT_EXECUTION_MODE
	bool "Enable SUIT execution mode module"
```

## subsys/suit/platform/Kconfig
```kconfig
#
# Copyright (c) 2023 Nordic Semiconductor ASA
#
# SPDX-License-Identifier: LicenseRef-Nordic-5-Clause
#

menuconfig SUIT_PLATFORM
        bool "Enable SUIT component implementations"
	depends on SUIT_PROCESSOR
	depends on SUIT_UTILS
	depends on SUIT_MEMPTR_STORAGE

if SUIT_PLATFORM

config SUIT_DEVCONFIG
	bool "Enable manifest authorization and installation"
	depends on SUIT_STORAGE
	depends on SUIT_MCI
	depends on SUIT_METADATA

config SUIT_DIGEST
	bool "Enable digest calculation"
	depends on SUIT_STREAM_SINK_DIGEST

config SUIT_DIGEST_CACHE
	bool "Enable digest caching"
	depends on SUIT_DIGEST

if SUIT_DIGEST_CACHE

config SUIT_DIGEST_CACHE_SIZE
	int "Maximum number of entries in the digest cache"
	default 16

endif

config SUIT_AUTHENTICATE
	bool "Enable message/data authentication"
	depends on SUIT_CRYPTO
	depends on SUIT_PLAT_CHECK_COMPONENT_COMPATIBILITY
	select PSA_WANT_ALG_SHA_256 if SOC_FAMILY_NRF
	select PSA_WANT_ALG_SHA_512 if SOC_FAMILY_NRF
	select PSA_WANT_ALG_ECDSA if SOC_FAMILY_NRF
	select PSA_WANT_ECC_SECP_R1_256 if SOC_FAMILY_NRF
	select PSA_WANT_ECC_TWISTED_EDWARDS_255 if SOC_FAMILY_NRF

config SUIT_PLAT_CHECK_COMPONENT_COMPATIBILITY
	bool "Enable component ID check against supported manifest class IDs"
	depends on SUIT_UTILS
	depends on SUIT_MCI
	depends on SUIT_METADATA

config SUIT_PLAT_CHECK_CLASSES
	bool "Enable vendor/class/device class ID checks"
	depends on SUIT_PLAT_CHECK_COMPONENT_COMPATIBILITY

config MAX_NUMBER_OF_MANIFEST_CLASS_IDS
	int  "Maximum number of supported manifest class IDs that can be handled"
	range 1 200
	default 8 if SOC_NRF54H20
	default 5 if SOC_NRF52840
	default 5 if SOC_POSIX
	help
		Check SUIT_STORAGE_N_ENVELOPES

config SUIT_CHECK_IMAGE_MATCH
	bool "Enable image digest verification"
	depends on SUIT_CRYPTO
	depends on SUIT_DIGEST
	depends on SUIT_STREAM
	depends on SUIT_STREAM_SINK_DIGEST
	depends on SUIT_STREAM_SOURCE_MEMPTR

rsource "sink_selector/Kconfig"
endif # SUIT_PLATFORM

config SUIT_CRYPTO
	bool "Enable crypto backend, suitable for SUIT components"
	imply MBEDTLS if !SOC_FAMILY_NRF
	imply NRF_SECURITY if SOC_FAMILY_NRF
	imply MBEDTLS_ENABLE_HEAP if SOC_FAMILY_NRF

if MBEDTLS
config SUIT_DEFAULT_MBEDTLS_CONFIG
	bool "Use default mbedTLS configuration file"
	default y
	select MBEDTLS_USER_CONFIG_ENABLE

config MBEDTLS_USER_CONFIG_FILE
	default "user-tls-conf.h" if SUIT_DEFAULT_MBEDTLS_CONFIG
endif
```

## subsys/suit/platform/legacy/Kconfig
```kconfig
#
# Copyright (c) 2023 Nordic Semiconductor ASA
#
# SPDX-License-Identifier: LicenseRef-Nordic-5-Clause
#

config SUIT_COMPONENT_RAMBUF
	bool "Include RAM buffer as NVM suit component implementation"
	depends on !SUIT_COMPONENT_MRAM

config SUIT_COMPONENT_MRAM
	bool "Include MRAM/Flash suit component implementation"
	depends on FLASH

config SUIT_MAX_ENVELOPE_REF_COMPONENTS
	int "The maximum number of envelope reference components that will be handled"
	range 1 255
	help
	  Index is of type uint8_t, which restricts number of components of this type to 255.
	  Default value is 8 and minimal 1.
	default 8

config SUIT_MAX_MRAM_COMPONENTS
	int "The maximum number of flash (MRAM) components that will be handled"
	range 1 255
	help
	  Index is of type uint8_t, which restricts number of components of this type to 255.
	  Default value is 8 and minimal 1.
	default 8
	depends on SUIT_COMPONENT_MRAM

config SUIT_CRYPTO
	bool "Enable crypto backend, suitable for SUIT components"
	imply MBEDTLS if !SOC_FAMILY_NRF
	imply NRF_SECURITY if SOC_FAMILY_NRF
	imply MBEDTLS_ENABLE_HEAP if SOC_FAMILY_NRF
	select PSA_WANT_ALG_SHA_256 if SOC_FAMILY_NRF
	select PSA_WANT_ALG_ECDSA if SOC_FAMILY_NRF
	select PSA_WANT_ECC_SECP_R1_256 if SOC_FAMILY_NRF
```

## subsys/suit/platform/sink_selector/Kconfig
```kconfig
#
# Copyright (c) 2023 Nordic Semiconductor ASA
#
# SPDX-License-Identifier: LicenseRef-Nordic-5-Clause
#

menuconfig SUIT_SINK_SELECTOR
        bool "Enable SUIT sink_selector module"
        depends on SUIT_STREAM

if SUIT_SINK_SELECTOR

endif # SUIT_SINK_SELECTOR
```
