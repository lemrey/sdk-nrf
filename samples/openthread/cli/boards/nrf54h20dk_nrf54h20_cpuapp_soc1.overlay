/*
 * Copyright (c) 2023 Nordic Semiconductor ASA
 *
 * SPDX-License-Identifier: Apache-2.0
 */
 #include <zephyr/dt-bindings/ipc_service/static_vrings.h>
 #include <arm/nordic_nrf_next/overlays/entropy_cpuapp.overlay>
 #include <arm/nordic_nrf_next/overlays/serial_cpuapp.overlay>

 / {
    chosen {
        zephyr,console = &uart136;
        zephyr,shell-uart = &uart136;
    };
};

ipc0: &ipc_cpurad { };
