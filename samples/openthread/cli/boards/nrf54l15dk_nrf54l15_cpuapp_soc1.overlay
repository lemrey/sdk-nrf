/*
 * Copyright (c) 2023 Nordic Semiconductor ASA
 *
 * SPDX-License-Identifier: Apache-2.0
 */

&uart30 {
    status = "okay";
    hw-flow-control;
};

 / {
    chosen {
        zephyr,console = &uart30;
        zephyr,shell-uart = &uart30;
    };
};
