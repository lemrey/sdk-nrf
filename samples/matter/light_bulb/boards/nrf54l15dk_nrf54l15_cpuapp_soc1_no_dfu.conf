## samples/matter/template/boards/nrf54h20_fpga_overlay.conf
```kconfig
#
# Copyright (c) 2023 Nordic Semiconductor ASA
#
# SPDX-License-Identifier: LicenseRef-Nordic-5-Clause
#

CONFIG_EMULATOR_FPGA=y
CONFIG_SHELL_ARGC_MAX=26
CONFIG_SHELL_CMD_BUFF_SIZE=416
CONFIG_CHIP_INCREASE_COMMISSIONING_TIMEOUTS=y
CONFIG_CHIP_COMMISSIONING_TIMEOUTS_MULTIPLIER=8
CONFIG_HEAP_MEM_POOL_SIZE=2048
CONFIG_SYSTEM_WORKQUEUE_STACK_SIZE=2048
CONFIG_NRF_802154_SER_DEFAULT_RESPONSE_TIMEOUT=100000
CONFIG_BT_L2CAP_TX_MTU=41
CONFIG_HEAP_MEM_POOL_SIZE=12288
CONFIG_GPIO_NRFX=n
CONFIG_DK_LIBRARY=n
```

## samples/matter/template/boards/nrf54h20_secdom_log_overlay.conf
```kconfig
#
# Copyright (c) 2023 Nordic Semiconductor ASA
#
# SPDX-License-Identifier: LicenseRef-Nordic-5-Clause
#

CONFIG_LOG=y
CONFIG_LOG_PRINTK=y
CONFIG_LOG_FRONTEND_CORESIGHT_STM=y
CONFIG_LOG_FRONTEND_CORESIGHT_STM_FSC=y
CONFIG_LOG_FRONTEND=y
CONFIG_LOG_FRONTEND_ONLY=y
CONFIG_SECDOM_STM_LOGGING_SUPPORT=y
CONFIG_SUIT_LOG_LEVEL_DBG=y
CONFIG_NRF_RPC_LOG_LEVEL_DBG=y
```

## samples/matter/template/boards/nrf54h20dk_nrf54h20_cpuapp_soc1_no_dfu.conf
```kconfig
#
# Copyright (c) 2023 Nordic Semiconductor ASA
#
# SPDX-License-Identifier: LicenseRef-Nordic-5-Clause
#

# Disable fprotect, as for now it's not supported on this board.
CONFIG_CHIP_NFC_COMMISSIONING=n
CONFIG_CHIP_OTA_REQUESTOR=n
CONFIG_CHIP_LIB_SHELL=y

CONFIG_FPROTECT=n
CONFIG_LOG_MODE_DEFERRED=y
CONFIG_MAIN_STACK_SIZE=12288
CONFIG_CHIP_MALLOC_SYS_HEAP_SIZE=28672
CONFIG_FPU=n
CONFIG_PRINTK_SYNC=y
CONFIG_HWINFO_NRF=n

CONFIG_BT_L2CAP_TX_MTU=247
CONFIG_BT_MAX_CONN=1

CONFIG_NET_PKT_RX_COUNT=10
CONFIG_NET_BUF_RX_COUNT=16
CONFIG_NET_BUF_TX_COUNT=16
CONFIG_NET_TX_STACK_SIZE=4096
CONFIG_NET_RX_STACK_SIZE=4096

CONFIG_NRF_REGTOOL_GENERATE_TOML_CONFIG=y

# Timestamp is currently broken in Wi-Fi build
CONFIG_LOG_BACKEND_FORMAT_TIMESTAMP=n
CONFIG_LOG_TRACE_SHORT_TIMESTAMP=n
CONFIG_WPA_SUPP_CRYPTO_PSA=y
CONFIG_WPA_SUPP_CRYPTO=n

CONFIG_ENTROPY_TEST_PRNG=y
CONFIG_MBOX_NRFX_IDS=y
CONFIG_USE_DT_CODE_PARTITION=n
CONFIG_NEWLIB_LIBC_NANO=n
```

## samples/matter/template/sample.yaml
```yaml
sample:
  description: Matter Template sample
  name: Matter Template
tests:
  # Excluded in quarantine.yaml to limit resources usage in integration builds
  sample.matter.template.release:
    build_only: true
    extra_args: CONF_FILE=prj_release.conf
    integration_platforms:
      - nrf52840dk_nrf52840
      - nrf5340dk_nrf5340_cpuapp
      - nrf7002dk_nrf5340_cpuapp
    platform_allow: nrf52840dk_nrf52840 nrf5340dk_nrf5340_cpuapp nrf7002dk_nrf5340_cpuapp
  sample.matter.template.no_dfu:
    build_only: true
    extra_args: CONF_FILE=prj_no_dfu.conf
    integration_platforms:
      - nrf21540dk_nrf52840
      - nrf54h20dk_nrf54h20_cpuapp@soc1
      - nrf54l15dk_nrf54l15_cpuapp@soc1
    platform_allow: >
      nrf52840dk_nrf52840 nrf21540dk_nrf52840 nrf5340dk_nrf5340_cpuapp nrf7002dk_nrf5340_cpuapp
      nrf54h20dk_nrf54h20_cpuapp@soc1 nrf54l15dk_nrf54l15_cpuapp@soc1
  sample.matter.template.debug:
    build_only: true
    integration_platforms:
      - nrf5340dk_nrf5340_cpuapp
      - nrf7002dk_nrf5340_cpuapp
    platform_allow: nrf52840dk_nrf52840 nrf5340dk_nrf5340_cpuapp nrf7002dk_nrf5340_cpuapp
  sample.matter.template.nrf54h20_fpga:
    build_only: true
    extra_args: CONF_FILE=prj_no_dfu.conf OVERLAY_CONFIG="boards/nrf54h20_fpga_overlay.conf"
    integration_platforms:
      - nrf54h20dk_nrf54h20_cpuapp@soc1
    platform_allow: nrf54h20dk_nrf54h20_cpuapp@soc1
    tags: ci_build
  sample.matter.template.nrf54l15_fpga:
    build_only: true
    extra_args: CONF_FILE=prj_no_dfu.conf OVERLAY_CONFIG="boards/nrf54l15_fpga_overlay.conf"
    integration_platforms:
      - nrf54l15dk_nrf54l15_cpuapp@soc1
    platform_allow: nrf54l15dk_nrf54l15_cpuapp@soc1
```

## samples/matter/window_covering/boards/nrf54l15dk_nrf54l15_cpuapp_soc1_no_dfu.conf
```kconfig
#
# Copyright (c) 2023 Nordic Semiconductor ASA
#
# SPDX-License-Identifier: LicenseRef-Nordic-5-Clause
#

# Disable fprotect, as for now it's not supported on this board.
CONFIG_CHIP_NFC_COMMISSIONING=n
CONFIG_CHIP_OTA_REQUESTOR=n
CONFIG_CHIP_QSPI_NOR=n
CONFIG_CHIP_LIB_SHELL=y

CONFIG_OBERON_BACKEND=y
CONFIG_PSA_CRYPTO_DRIVER_OBERON=y
CONFIG_PSA_CRYPTO_DRIVER_CC3XX=n
CONFIG_CRACEN=y

CONFIG_BT_MAX_CONN=1
CONFIG_BT_LL_SOFTDEVICE_MULTIROLE=y

CONFIG_FPROTECT=n
CONFIG_LOG_MODE_DEFERRED=y
CONFIG_FPU=n
CONFIG_PM=n
CONFIG_PRINTK_SYNC=y
CONFIG_HWINFO_NRF=n

CONFIG_NRF_802154_TEMPERATURE_UPDATE=n

# Temporary disable PWM support until it is supported.
CONFIG_PWM=n
# To be deleted when the full button support will be available
CONFIG_CHIP_ENABLE_PAIRING_AUTOSTART=y
```

## samples/multicore/hello_world/Kconfig
```kconfig
#
# Copyright (c) 2023 Nordic Semiconductor ASA
#
# SPDX-License-Identifier: LicenseRef-Nordic-5-Clause
#

source "Kconfig.zephyr"

config BOARD_ENABLE_CPUNET_HELPER
	bool "Include net image as sub image"
	depends on SOC_NRF5340_CPUAPP
	default y if (BOARD_NRF5340DK_NRF5340_CPUAPP || BOARD_NRF5340DK_NRF5340_CPUAPP_NS)
	select BOARD_ENABLE_CPUNET
```

## samples/multicore/hello_world/Kconfig.sysbuild
```kconfig
#
# Copyright (c) 2023 Nordic Semiconductor ASA
#
# SPDX-License-Identifier: LicenseRef-Nordic-5-Clause
#

source "share/sysbuild/Kconfig"

config REMOTE_BOARD
	string "The board used for remote target"
	default "nrf5340dk_nrf5340_cpunet" if $(BOARD) = "nrf5340dk_nrf5340_cpuapp"
	default "nrf5340dk_nrf5340_cpunet" if $(BOARD) = "nrf5340dk_nrf5340_cpuapp_ns"
	#default "nrf54h20dk_nrf54h20_cpuppr@soc1" if ($(BOARD) = "nrf54h20dk_nrf54h20_cpuapp" && HW_REVISION_SOC1)
	default "nrf54h20dk_nrf54h20_cpuppr@soc1" if ($(BOARD) = "nrf54h20dk_nrf54h20_cpuapp")
	default "nrf7140dk_nrf7140_cpuppr" if ($(BOARD) = "nrf7140dk_nrf7140_cpuapp")
	default "UNKNOWN"
```

## samples/multicore/hello_world/boards/nrf54h20dk_nrf54h20_cpuapp_soc1.conf
```kconfig
CONFIG_NRF_REGTOOL_TOML_CONFIG_FILES="uicr/nrf54h20dk_nrf54h20_cpuapp.toml"
CONFIG_SERIAL=y
CONFIG_CONSOLE=y
```

## samples/multicore/hello_world/sample.yaml
```yaml
sample:
    name: Multicore Hello World
    description: Hello World application that builds remote core from sources.
                 Both cores prints board name they were run on.
tests:
  sample.multicore.hello_world:
    build_only: true
    platform_allow: nrf5340dk_nrf5340_cpuapp
    integration_platforms:
      - nrf5340dk_nrf5340_cpuapp
    tags: ci_build
  sample.multicore.hello_world.nrf54h20:
    build_only: true
    platform_allow: nrf54h20dk_nrf54h20_cpuapp@soc1
    integration_platforms:
      - nrf54h20dk_nrf54h20_cpuapp@soc1
    tags: ci_build
  sample.multicore.hello_world.nrf54h20.stm_logging_fsc_frontend:
    build_only: true
    platform_allow: nrf54h20dk_nrf54h20_cpuapp@soc1
    integration_platforms:
      - nrf54h20dk_nrf54h20_cpuapp@soc1
    tags: ci_build
    extra_args:
      DTC_OVERLAY_FILE="boards/nrf54h20dk_nrf54h20_cpuapp_soc1_stm_logging.overlay"
      remote_DTC_OVERLAY_FILE="boards/nrf54h20dk_nrf54h20_cpuppr_soc1_stm_logging.overlay"
      remote_CONFIG_LOG_STM=y remote_CONFIG_UART_CONSOLE=n remote_CONFIG_CONSOLE=n
    extra_configs:
      - CONFIG_LOG_STM=y
      - CONFIG_SECDOM_STM_LOGGING_SUPPORT=y
      - CONFIG_SERIAL=n
      - CONFIG_CONSOLE=n
  sample.multicore.hello_world.nrf54h20.fpga:
    build_only: true
    platform_allow: nrf54h20dk_nrf54h20_cpuapp@soc1
    integration_platforms:
      - nrf54h20dk_nrf54h20_cpuapp@soc1
    tags: ci_build
    extra_args: remote_CONFIG_EMULATOR_FPGA=y
    extra_configs:
      - CONFIG_EMULATOR_FPGA=y
  sample.multicore.hello_world.nrf54h20.fpga.stm_logging_fsc_frontend:
    build_only: true
    platform_allow: nrf54h20dk_nrf54h20_cpuapp@soc1
    integration_platforms:
      - nrf54h20dk_nrf54h20_cpuapp@soc1
    tags: ci_build
    extra_args:
      DTC_OVERLAY_FILE="boards/nrf54h20dk_nrf54h20_cpuapp_soc1_stm_logging.overlay"
      remote_DTC_OVERLAY_FILE="boards/nrf54h20dk_nrf54h20_cpuppr_soc1_stm_logging.overlay"
      remote_CONFIG_LOG_STM=y remote_CONFIG_UART_CONSOLE=n remote_CONFIG_CONSOLE=n remote_CONFIG_EMULATOR_FPGA=y
    extra_configs:
      - CONFIG_LOG_STM=y
      - CONFIG_EMULATOR_FPGA=y
      - CONFIG_SECDOM_STM_LOGGING_SUPPORT=y
      - CONFIG_SERIAL=n
      - CONFIG_CONSOLE=n
```

## samples/nfc/record_launch_app/sample.yaml
```yaml
sample:
  description: NFC Launch App sample
  name: NFC Launch App
tests:
  sample.nfc.launch_app:
    build_only: true
    integration_platforms:
      - nrf52840dk_nrf52840
      - nrf52dk_nrf52832
      - nrf5340dk_nrf5340_cpuapp
      - nrf5340dk_nrf5340_cpuapp_ns
      - nrf54h20dk_nrf54h20_cpuapp@soc1
      - nrf54l15dk_nrf54l15_cpuapp@soc1
    platform_allow: >
      nrf52840dk_nrf52840
      nrf52dk_nrf52832
      nrf5340dk_nrf5340_cpuapp
      nrf5340dk_nrf5340_cpuapp_ns
      nrf54h20dk_nrf54h20_cpuapp@soc1
      nrf54l15dk_nrf54l15_cpuapp@soc1
    tags: ci_build
```

## samples/openthread/cli/sample.yaml
```yaml
sample:
  name: OpenThread CLI sample
  description: Test OpenThread Command Line Interface.
tests:
  sample.openthread.cli:
    build_only: true
    platform_allow: nrf5340dk_nrf5340_cpuapp nrf5340dk_nrf5340_cpuapp_ns nrf52840dk_nrf52840 nrf21540dk_nrf52840
    tags: ci_build
    extra_args: OVERLAY_CONFIG=overlay-ci.conf;overlay-multiprotocol.conf;overlay-tcp.conf
    integration_platforms:
      - nrf5340dk_nrf5340_cpuapp
      - nrf5340dk_nrf5340_cpuapp_ns
      - nrf52840dk_nrf52840
      - nrf21540dk_nrf52840
  sample.openthread.cli_hadron:
    build_only: true
    platform_allow: nrf52833dk_nrf52833
    tags: ci_build
    extra_args: OVERLAY_CONFIG=overlay-ci.conf
    integration_platforms:
      - nrf52833dk_nrf52833
  sample.openthread.cli.thread_1_1:
    build_only: true
    platform_allow: nrf5340dk_nrf5340_cpuapp nrf5340dk_nrf5340_cpuapp_ns nrf52840dk_nrf52840 nrf21540dk_nrf52840
    tags: ci_build
    extra_args: CONFIG_OPENTHREAD_THREAD_VERSION_1_1=y
                OVERLAY_CONFIG=overlay-ci.conf;overlay-multiprotocol.conf
    integration_platforms:
      - nrf5340dk_nrf5340_cpuapp
      - nrf5340dk_nrf5340_cpuapp_ns
      - nrf52840dk_nrf52840
      - nrf21540dk_nrf52840
  sample.openthread.cli.usb:
    build_only: true
    platform_allow: nrf5340dk_nrf5340_cpuapp nrf5340dk_nrf5340_cpuapp_ns nrf52840dk_nrf52840 nrf52840dongle_nrf52840 nrf21540dk_nrf52840
    tags: ci_build
    extra_args: OVERLAY_CONFIG=overlay-usb.conf;overlay-ci.conf;overlay-multiprotocol.conf;overlay-tcp.conf
                DTC_OVERLAY_FILE=usb.overlay
    integration_platforms:
      - nrf5340dk_nrf5340_cpuapp
      - nrf5340dk_nrf5340_cpuapp_ns
      - nrf52840dk_nrf52840
      - nrf52840dongle_nrf52840
      - nrf21540dk_nrf52840
  sample.openthread.cli.low_power:
    build_only: true
    platform_allow: nrf5340dk_nrf5340_cpuapp nrf52840dk_nrf52840 nrf21540dk_nrf52840
    tags: ci_build
    extra_args: OVERLAY_CONFIG=overlay-ci.conf;overlay-low_power.conf
                DTC_OVERLAY_FILE=low_power.overlay
    integration_platforms:
      - nrf5340dk_nrf5340_cpuapp
      - nrf52840dk_nrf52840
      - nrf21540dk_nrf52840
  sample.openthread.cli_nrf54h20:
    build_only: true
    extra_args: OVERLAY_CONFIG=overlay-ci.conf
                DTC_OVERLAY_FILE=entropy_cpuapp.overlay;serial_cpuapp.overlay;boards/nrf54h20dk_nrf54h20_cpuapp_soc1.overlay
    integration_platforms:
      - nrf54h20dk_nrf54h20_cpuapp@soc1
    platform_allow: nrf54h20dk_nrf54h20_cpuapp@soc1
    tags: ci_build
  sample.openthread.cli_multiprotocol_nrf54h20:
    build_only: true
    extra_args: OVERLAY_CONFIG=overlay-ci.conf;overlay-multiprotocol.conf
                DTC_OVERLAY_FILE=entropy_cpuapp.overlay;serial_cpuapp.overlay;boards/nrf54h20dk_nrf54h20_cpuapp_soc1.overlay
    integration_platforms:
      - nrf54h20dk_nrf54h20_cpuapp@soc1
    platform_allow: nrf54h20dk_nrf54h20_cpuapp@soc1
    tags: ci_build
  # Build integration regression protection.
  sample.nrf_security.openthread.integration:
      build_only: true
      extra_args: CONFIG_NRF_SECURITY=y
      platform_allow: nrf5340dk_nrf5340_cpuapp_ns nrf52840dk_nrf52840
      integration_platforms:
          - nrf5340dk_nrf5340_cpuapp_ns
          - nrf52840dk_nrf52840
```

## samples/openthread/coprocessor/Kconfig
```kconfig
#
# Copyright (c) 2020 Nordic Semiconductor ASA
#
# SPDX-License-Identifier: LicenseRef-Nordic-5-Clause
#

menu "Zephyr Kernel"
source "Kconfig.zephyr"
endmenu

config NRF_802154_AIFS_TIME
	int "AIFS time"
	default 1300
	depends on FPGA_TIMING_COMPATIBILITY
	help
	  Set ACK IFS time for NRF54 FPGA.

module = OT_COPROCESSOR
module-str = ot_coprocessor
source "${ZEPHYR_BASE}/subsys/logging/Kconfig.template.log_config"
```
