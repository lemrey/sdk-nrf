## samples/matter/light_bulb/boards/nrf54l15dk_nrf54l15_cpuapp_soc1_no_dfu.conf
```kconfig
#
# Copyright (c) 2023 Nordic Semiconductor ASA
#
# SPDX-License-Identifier: LicenseRef-Nordic-5-Clause
#

# Disable fprotect, as for now it's not supported on this board.
CONFIG_CHIP_NFC_COMMISSIONING=n
CONFIG_CHIP_OTA_REQUESTOR=n
CONFIG_CHIP_LIB_SHELL=y
CONFIG_CHIP_MALLOC_SYS_HEAP_SIZE=28672

CONFIG_OBERON_BACKEND=y
CONFIG_PSA_CRYPTO_DRIVER_OBERON=y
CONFIG_PSA_CRYPTO_DRIVER_CC3XX=n
CONFIG_CRACEN=y

CONFIG_BT_MAX_CONN=1
CONFIG_BT_LL_SOFTDEVICE_MULTIROLE=y

CONFIG_FPROTECT=n
CONFIG_MAIN_STACK_SIZE=12288
CONFIG_LOG_MODE_MINIMAL=y
CONFIG_ASSERT=n
CONFIG_FPU=n
CONFIG_PM=n
CONFIG_PRINTK_SYNC=y
CONFIG_HWINFO_NRF=n

CONFIG_NRF_802154_TEMPERATURE_UPDATE=n
```

## samples/matter/light_bulb/sample.yaml
```yaml
sample:
  description: Matter Light Bulb example
  name: Matter Light Bulb
tests:
  sample.matter.light_bulb.release:
    build_only: true
    extra_args: CONF_FILE=prj_release.conf
    integration_platforms:
      - nrf52840dk_nrf52840
      - nrf5340dk_nrf5340_cpuapp
      - nrf7002dk_nrf5340_cpuapp
    platform_allow: nrf52840dk_nrf52840 nrf5340dk_nrf5340_cpuapp nrf7002dk_nrf5340_cpuapp
  sample.matter.light_bulb.ffs:
    build_only: true
    extra_args: >
      CONFIG_CHIP_COMMISSIONABLE_DEVICE_TYPE=y CONFIG_CHIP_ROTATING_DEVICE_ID=y
      CONFIG_CHIP_DEVICE_TYPE=257
    integration_platforms:
      - nrf52840dk_nrf52840
      - nrf5340dk_nrf5340_cpuapp
      - nrf7002dk_nrf5340_cpuapp
    platform_allow: nrf52840dk_nrf52840 nrf5340dk_nrf5340_cpuapp nrf7002dk_nrf5340_cpuapp
  # Sample to execute load tests
  sample.matter.light_bulb.persistent_subscriptions:
    build_only: true
    extra_args: CONFIG_CHIP_PERSISTENT_SUBSCRIPTIONS=y
    platform_allow: nrf52840dk_nrf52840 nrf5340dk_nrf5340_cpuapp nrf7002dk_nrf5340_cpuapp
    integration_platforms:
      - nrf52840dk_nrf52840
      - nrf5340dk_nrf5340_cpuapp
      - nrf7002dk_nrf5340_cpuapp
  sample.matter.light_bulb.no_dfu:
    build_only: true
    extra_args: CONF_FILE=prj_no_dfu.conf
    integration_platforms:
      - nrf54l15dk_nrf54l15_cpuapp@soc1
    platform_allow: nrf54l15dk_nrf54l15_cpuapp@soc1
```

## samples/matter/lock/Kconfig
```kconfig
#
# Copyright (c) 2021 Nordic Semiconductor
#
# SPDX-License-Identifier: LicenseRef-Nordic-5-Clause
#

mainmenu "Matter Lock sample application"

config LOCK_NUM_USERS
	int "Maximum number of users supported by lock"
	default 10

config LOCK_NUM_CREDENTIALS
	int "Maximum number of credentials supported by lock"
	default 20

config LOCK_NUM_CREDENTIALS_PER_USER
	int "Maximum number of credentials per user supported by lock"
	default 3

# Sample configuration used for Thread networking
if NET_L2_OPENTHREAD

choice OPENTHREAD_NORDIC_LIBRARY_CONFIGURATION
	default OPENTHREAD_NORDIC_LIBRARY_MTD
endchoice

choice OPENTHREAD_DEVICE_TYPE
	default OPENTHREAD_MTD
endchoice

config CHIP_ENABLE_SLEEPY_END_DEVICE_SUPPORT
	bool
	default y

endif # NET_L2_OPENTHREAD

if !(SOC_SERIES_NRF54HX) && !(CONFIG_EMULATOR_FPGA)

config STATE_LEDS
	bool "Use LEDs to indicate the device state"
	default y
	help
	  Use LEDs to render the current state of the device such as the progress of commissioning of
	  the device into a network or the factory reset initiation. Note that setting this option to
	  'n' does not disable the LED indicating the state of the simulated bolt.

if MPSL_FEM

config OPENTHREAD_DEFAULT_TX_POWER
	int "Set the default 802.15.4 output power (dBm) for device with FEM"
	range -40 20
	default 20
	help
	  Use this setting to set the default Thread (802.15.4) output power for device that
	  uses FEM. This value has a unit in dBm and represents the Tx power at Antenna port of FEM device.

# override FEM GAIN to 20 dB as a default
# see subsys/mpsl/fem/Kconfig
# Leave MPSL_FEM_NRF21540_TX_GAIN_DB unchanged when OPENTHREAD_DEFAULT_TX_POWER=0
# to set the output power to a similar value as for nRF52840DK.
config MPSL_FEM_NRF21540_TX_GAIN_DB
	default 20 if OPENTHREAD_DEFAULT_TX_POWER != 0

endif # MPSL_FEM


source "${ZEPHYR_BASE}/../modules/lib/matter/config/nrfconnect/chip-module/Kconfig.features"
source "${ZEPHYR_BASE}/../modules/lib/matter/config/nrfconnect/chip-module/Kconfig.defaults"

endif # !(SOC_SERIES_NRF54HX) && !(CONFIG_EMULATOR_FPGA)

if (CONFIG_EMULATOR_FPGA || SOC_SERIES_NRF54HX)

config MBEDTLS_USER_CONFIG_ENABLE
	default y

config MBEDTLS_USER_CONFIG_FILE
	default "${ZEPHYR_BASE}/../nrf/samples/matter/lock/mbedtls_config.h"

config GPIO_NRFX
	default n

config CHIP_LIB_SHELL
	default y

config MATTER_LOCK_MRAM_SETTINGS
	bool "Enable MRAM as settings backend"
	help
	  Use this settings to enable MRAM as settings backend for Matter Lock sample,
	  If that config is disabled Zephyr's settings will be stored in ram using Flash Simulator.

if !(MATTER_LOCK_MRAM_SETTINGS)

	# simulate flash to store settings in RAM
	config SOC_FLASH_NRF
		bool
		default n

	config FLASH_SIMULATOR
		bool
		default y

	config FLASH_SIMULATOR_UNALIGNED_READ
		bool
		default y

	config FLASH_SIMULATOR_DOUBLE_WRITES
		bool
		default y

endif # MATTER_LOCK_MRAM_SETTINGS

source "${ZEPHYR_BASE}/../nrf/samples/matter/lock/configuration/next/Kconfig.next"
source "${ZEPHYR_BASE}/../modules/lib/matter/config/nrfconnect/chip-module/Kconfig.features"

endif # SOC_SERIES_NRF54HX

source "Kconfig.zephyr"
```

## samples/matter/lock/boards/nrf54h20dk_nrf54h20_cpuapp_soc1.conf
```kconfig
#
# Copyright (c) 2023 Nordic Semiconductor ASA
#
# SPDX-License-Identifier: LicenseRef-Nordic-5-Clause
#

# Disable fprotect, as for now it's not supported on this board.
CONFIG_CHIP_NFC_COMMISSIONING=n
CONFIG_CHIP_OTA_REQUESTOR=n
CONFIG_CHIP_LIB_SHELL=n

CONFIG_FPROTECT=n
CONFIG_LOG_MODE_DEFERRED=y
CONFIG_MAIN_STACK_SIZE=12288
CONFIG_CHIP_MALLOC_SYS_HEAP_SIZE=28672
CONFIG_PRINTK_SYNC=y
CONFIG_HWINFO_NRF=n

CONFIG_BT_L2CAP_TX_MTU=247
CONFIG_BT_MAX_CONN=1

CONFIG_NET_PKT_RX_COUNT=10
CONFIG_NET_BUF_RX_COUNT=16
CONFIG_NET_BUF_TX_COUNT=16

CONFIG_NRF_REGTOOL_GENERATE_TOML_CONFIG=y

CONFIG_OPENTHREAD_SHELL=n
CONFIG_SHELL_MINIMAL=y
CONFIG_BT_GATT_CACHING=n
CONFIG_HWINFO_SHELL=n
CONFIG_MBEDTLS_SSL_COOKIE_C=n
CONFIG_MBEDTLS_SSL_SRV_C=n

# Enable SUIT services
CONFIG_SUIT=y
CONFIG_MGMT_SUITFU=y

# Enable SUIT envelope creation
CONFIG_SUIT_ENVELOPE=y

# # Allow for large Bluetooth data packets.
CONFIG_BT_L2CAP_TX_MTU=498
CONFIG_BT_BUF_ACL_RX_SIZE=502
CONFIG_BT_BUF_ACL_TX_SIZE=502

# # Enable mcumgr
CONFIG_ZCBOR=y
CONFIG_MCUMGR=y
CONFIG_BOOTLOADER_MCUBOOT=n
CONFIG_IMG_MANAGER=n
CONFIG_MCUMGR_SMP_LEGACY_RC_BEHAVIOUR=y

# # Enable the Bluetooth mcumgr transport (unauthenticated).
CONFIG_MCUMGR_TRANSPORT_BT=y
CONFIG_MCUMGR_TRANSPORT_BT_AUTHEN=n
CONFIG_MCUMGR_TRANSPORT_BT_CONN_PARAM_CONTROL=y

# # Enable the mcumgr Packet Reassembly feature over Bluetooth and its configuration dependencies.
# # MCUmgr buffer size is optimized to fit one SMP packet divided into five Bluetooth Write Commands,
# # transmitted with the maximum possible MTU value: 498 bytes.
CONFIG_MCUMGR_TRANSPORT_BT_REASSEMBLY=y
CONFIG_MCUMGR_TRANSPORT_NETBUF_SIZE=2475
CONFIG_MCUMGR_TRANSPORT_NETBUF_COUNT=6
CONFIG_MCUMGR_TRANSPORT_WORKQUEUE_STACK_SIZE=4096
```

## samples/matter/lock/boards/nrf54h20dk_nrf54h20_cpuapp_soc1_no_dfu.conf
```kconfig
#
# Copyright (c) 2023 Nordic Semiconductor ASA
#
# SPDX-License-Identifier: LicenseRef-Nordic-5-Clause
#

# Disable fprotect, as for now it's not supported on this board.
CONFIG_FPROTECT=n
```

## samples/matter/lock/boards/nrf54l15_fpga_overlay.conf
```kconfig
#
# Copyright (c) 2023 Nordic Semiconductor ASA
#
# SPDX-License-Identifier: LicenseRef-Nordic-5-Clause
#

CONFIG_EMULATOR_FPGA=y
CONFIG_SYSTEM_WORKQUEUE_STACK_SIZE=2048
CONFIG_GPIO_NRFX=n
CONFIG_GPIO=n
CONFIG_DK_LIBRARY=n
```

## samples/matter/lock/child_image/hci_rpmsg/boards/nrf54h20dk_nrf54h20_cpurad_soc1.conf
```kconfig
CONFIG_MBOX=y
CONFIG_IPC_SERVICE=y
CONFIG_MBOX_NRFX_IDS=y
CONFIG_HEAP_MEM_POOL_SIZE=4096
```

## samples/matter/lock/configuration/next/Kconfig.next
```kconfig
#
#   Copyright (c) 2022 Project CHIP Authors
#
#   Licensed under the Apache License, Version 2.0 (the "License");
#   you may not use this file except in compliance with the License.
#   You may obtain a copy of the License at
#
#       http://www.apache.org/licenses/LICENSE-2.0
#
#   Unless required by applicable law or agreed to in writing, software
#   distributed under the License is distributed on an "AS IS" BASIS,
#   WITHOUT WARRANTIES OR CONDITIONS OF ANY KIND, either express or implied.
#   See the License for the specific language governing permissions and
#   limitations under the License.
#

# The purpose of this file is to define new default values of settings used when building Matter samples.
# This file only changes defaults and thus all symbols here must be promptless
# and safeguarded so that they only are applied when building Matter.

if EMULATOR_FPGA

config SHELL_ARGC_MAX
    default 26

config SHELL_CMD_BUFF_SIZE
    default 416

config CHIP_INCREASE_COMMISSIONING_TIMEOUTS
    default y

config CHIP_COMMISSIONING_TIMEOUTS_MULTIPLIER
    default 8

config HEAP_MEM_POOL_SIZE
    default 2048

config SYSTEM_WORKQUEUE_STACK_SIZE
    default 2048

endif # EMULATOR_FPGA

################################################
# LILIUM SPECIFIC SECTION START
################################################
if BOARD_NRF54H20DK_NRF54H20_CPUAPP

# These configs should be moved out of this section, 
# when Moonlight will work with assert and log_minimal enabled.
choice LOG_MODE
    default LOG_MODE_DEFERRED
endchoice

config CHIP_NFC_COMMISSIONING
    default n

# As long as there is no flash storage on FPGA DFUs must be disabled
config CHIP_OTA_REQUESTOR
    default n
    
config TEST_RANDOM_GENERATOR
    default y

choice OPENTHREAD_SECURITY
    default OPENTHREAD_MBEDTLS_CHOICE
endchoice

config OPENTHREAD_NRF_SECURITY
    default n

config MAIN_STACK_SIZE
    default 12288

config CHIP_MALLOC_SYS_HEAP_SIZE
    default 28672 # 28 kB

config HWINFO_NRF
    default n

config NET_PKT_RX_COUNT
    default 10

config NET_BUF_RX_COUNT
    default 16

config NET_BUF_TX_COUNT
    default 16

config FPU
    default n

config MBEDTLS_USER_CONFIG_ENABLE
	default y

config MBEDTLS_USER_CONFIG_FILE
	default "${ZEPHYR_BASE}/../nrf/samples/matter/lock/mbedtls_config.h"

config BT_L2CAP_TX_MTU
    default 247

config PRINTK_SYNC
    default y

# Settings needed to handle IPC service and
# communication between domains
config IPC_SERVICE_BACKEND_RPMSG_SHMEM_RESET
    default y

config MBOX
    default y

config MBOX_NRFX_IDS
    default y

# Generate TOML file during each build
config NRF_REGTOOL_GENERATE_TOML_CONFIG
    default y

config CHIP_LIB_SHELL
	default y

# Temporary workaround for LEDS until nrfjprog does not support adding gpio to UICR
config NRF_REGTOOL_TOML_CONFIG_FILES
	default "boards/nrf54h20_pdk.toml"

if EMULATOR_FPGA

# TODO to check if it is still needed here
config NRF_802154_SER_DEFAULT_RESPONSE_TIMEOUT
    default 100000

config BT_L2CAP_TX_MTU
    default 41

# TODO to check if it is still needed here
config HEAP_MEM_POOL_SIZE
    default 12288

config GPIO_NRFX
	default n

endif # EMULATOR_FPGA
endif #BOARD_NRF54H20DK_NRF54H20_CPUAPP


################################################
# MOONLIGHT SECTION START
################################################
if BOARD_NRF54L15DK_NRF54L15_CPUAPP

choice LOG_MODE
    default LOG_MODE_DEFERRED
endchoice

# This config should be deleted from here 
# when radio driver will be fixed.
config NRF_802154_TEMPERATURE_UPDATE
    default n

# There are some issues in IEEE802154 that cause assert, 
# but it driver works with it.
# This should be changed to y after fixes in radio driver.
config ASSERT
    default n

config FPU
    default n

if EMULATOR_FPGA

# Increased ACK timeouts, but it will be deleted
# in the future, because Moonlight image will be 
# able to work with normal ACK timeout.
config NRF_802154_ACK_TIMEOUT_CUSTOM_US
    default 2000

endif # EMULATOR_FPGA

endif #BOARD_NRF54LFPGA_NRF54L15_SOC1_CPUAPP
################################################
# MOONLIGHT SPECIFIC SECTION END
################################################
```

## samples/matter/lock/sample.yaml
```yaml
sample:
  description: Matter Lock example
  name: Matter Lock
tests:
  sample.matter.lock.debug:
    build_only: true
    integration_platforms:
      - nrf52840dk_nrf52840
      - nrf5340dk_nrf5340_cpuapp
      - nrf7002dk_nrf5340_cpuapp
    platform_allow: nrf52840dk_nrf52840 nrf5340dk_nrf5340_cpuapp nrf7002dk_nrf5340_cpuapp
    tags: ci_build
  sample.matter.lock.no_dfu:
    build_only: true
    extra_args: CONF_FILE=prj_no_dfu.conf
    integration_platforms:
      - nrf52840dk_nrf52840
      - nrf5340dk_nrf5340_cpuapp
      - nrf21540dk_nrf52840
      - nrf7002dk_nrf5340_cpuapp
    platform_allow: nrf52840dk_nrf52840 nrf5340dk_nrf5340_cpuapp nrf21540dk_nrf52840 nrf7002dk_nrf5340_cpuapp
    tags: ci_build
  sample.matter.lock.release:
    build_only: true
    extra_args: CONF_FILE=prj_release.conf
    integration_platforms:
      - nrf52840dk_nrf52840
      - nrf5340dk_nrf5340_cpuapp
      - nrf7002dk_nrf5340_cpuapp
    platform_allow: nrf52840dk_nrf52840 nrf5340dk_nrf5340_cpuapp nrf7002dk_nrf5340_cpuapp
    tags: ci_build
  sample.matter.lock.smp_dfu_ffs:
    build_only: true
    extra_args: CONFIG_CHIP_DFU_OVER_BT_SMP=y CONFIG_CHIP_LIB_SHELL=y CONFIG_CHIP_COMMISSIONABLE_DEVICE_TYPE=y
      CONFIG_CHIP_ROTATING_DEVICE_ID=y CONFIG_CHIP_DEVICE_TYPE=10
    integration_platforms:
      - nrf52840dk_nrf52840
      - nrf5340dk_nrf5340_cpuapp
    platform_allow: nrf52840dk_nrf52840 nrf5340dk_nrf5340_cpuapp
    tags: ci_build
  sample.matter.lock.smp_dfu_ffs_wifi:
    build_only: true
    extra_args: CONFIG_NET_SHELL=y CONFIG_CHIP_DFU_OVER_BT_SMP=y CONFIG_CHIP_LIB_SHELL=y
      CONFIG_CHIP_COMMISSIONABLE_DEVICE_TYPE=y CONFIG_CHIP_ROTATING_DEVICE_ID=y CONFIG_CHIP_DEVICE_TYPE=10
    integration_platforms:
      - nrf7002dk_nrf5340_cpuapp
    platform_allow: nrf7002dk_nrf5340_cpuapp
    tags: ci_build
  sample.matter.lock.no_dfu.nrf7002_ek:
    build_only: true
    extra_args: SHIELD=nrf7002_ek CONF_FILE=prj_no_dfu.conf
    integration_platforms:
      - nrf5340dk_nrf5340_cpuapp
    platform_allow: nrf5340dk_nrf5340_cpuapp
    tags: ci_build
  sample.matter.lock.fpga:
    build_only: true
    extra_args: CONF_FILE=prj_fpga.conf
      DTC_OVERLAY_FILE="serial_cpuapp.overlay;boards/nrf54h20dk_nrf54h20_cpuapp_soc1.overlay"
    integration_platforms:
      - nrf54h20dk_nrf54h20_cpuapp@soc1
    platform_allow: nrf54h20dk_nrf54h20_cpuapp@soc1
    tags: ci_build
  sample.matter.lock.lilium_pdk:
    build_only: true
    extra_args: CONF_FILE=prj_no_dfu.conf
      DTC_OVERLAY_FILE="serial_cpuapp.overlay;boards/nrf54h20dk_nrf54h20_cpuapp_soc1.overlay"
    integration_platforms:
      - nrf54h20dk_nrf54h20_cpuapp@soc1
    platform_allow: nrf54h20dk_nrf54h20_cpuapp@soc1
    tags: ci_build
```

## samples/matter/template/Kconfig
```kconfig
#
# Copyright (c) 2022 Nordic Semiconductor
#
# SPDX-License-Identifier: LicenseRef-Nordic-5-Clause
#
mainmenu "Matter nRF Connect Template Example Application"

# Sample configuration used for Thread networking
if NET_L2_OPENTHREAD

choice OPENTHREAD_NORDIC_LIBRARY_CONFIGURATION
	default OPENTHREAD_NORDIC_LIBRARY_MTD
endchoice

choice OPENTHREAD_DEVICE_TYPE
	default OPENTHREAD_MTD
endchoice

endif # NET_L2_OPENTHREAD

# TODO Temporary workaround for nRF54L15 target
if SOC_NRF54L15

config FPU
	default n
	
endif

source "${ZEPHYR_BASE}/../modules/lib/matter/config/nrfconnect/chip-module/Kconfig.features"
source "${ZEPHYR_BASE}/../modules/lib/matter/config/nrfconnect/chip-module/Kconfig.defaults"
source "Kconfig.zephyr"
```
