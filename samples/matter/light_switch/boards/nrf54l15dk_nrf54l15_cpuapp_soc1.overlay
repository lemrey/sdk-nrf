/*
 * Copyright (c) 2022 Nordic Semiconductor ASA
 *
 * SPDX-License-Identifier: Apache-2.0
 */

/* Matter needs at least 700 kB Flash size, instead of default 344 kB */
&slot0_partition {
    label = "image-0";
    reg = <0 0xefe00>;
};
