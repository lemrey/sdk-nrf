/*
 * Copyright (c) 2023 Nordic Semiconductor ASA
 *
 * SPDX-License-Identifier: Apache-2.0
 */

&cpuapp_ram0x_s {
    reg = <0x0 DT_SIZE_K(512)>;
    ranges = <0x0 0x0 DT_SIZE_K(512)>;
};

&cpuapp_sram0x {
    reg = <0x1000 DT_SIZE_K(512)>;
};

&cpurad_ram0x_s {
    reg = <0x58800 DT_SIZE_K(4)>;
    ranges = <0x0 0x58800 DT_SIZE_K(4)>;
};
