/*
 * Copyright (c) 2022 Nordic Semiconductor ASA
 *
 * SPDX-License-Identifier: Apache-2.0
 */

 /delete-node/ &flash_controller2;

 &mram_controller{
     mram1: mram@1e1FA000 {
         compatible = "nordic,allocatable-mram", "soc-nv-flash";
         reg = < 0x1e1FA000 DT_SIZE_K(24) >;
         erase-block-size = < 4096 >;
         write-block-size = < 0x1 >;
         perm-read;
         perm-write;
         partitions {
             compatible = "fixed-partitions";
             #address-cells = < 0x1 >;
             #size-cells = < 0x1 >;
             storage_partition: partition@1FA000 {
                 label = "storage";
                 reg = < 0x1FA000 DT_SIZE_K(24) >;
             };
         };
     };
 };
