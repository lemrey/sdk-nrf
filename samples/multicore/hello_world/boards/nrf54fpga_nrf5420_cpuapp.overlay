/*
 * Copyright (c) 2022 Nordic Semiconductor ASA
 *
 * SPDX-License-Identifier: LicenseRef-Nordic-5-Clause
 */

 &uart136 {
	 status = "okay";
	 tx-pin = <5>;
	 rx-pin = <4>;
 };

 / {
	chosen {
		zephyr,console = &uart136;
	};
};
