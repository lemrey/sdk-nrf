/*
 * Copyright (c) 2022 Nordic Semiconductor ASA
 *
 * SPDX-License-Identifier: LicenseRef-Nordic-5-Clause
 */

 / {
	chosen {
		zephyr,console = &uart135;
	};
};

&uart135 {
	status = "okay";
};

ipc0: &ipc_to_cpuapp {
	status = "okay";
};
