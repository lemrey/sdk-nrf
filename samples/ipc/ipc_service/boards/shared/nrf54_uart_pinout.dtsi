#if 1

&uart136 {
	tx-pin = < 0x5 >;
	rx-pin = < 0x4 >;
};

&uart135 {
	tx-pin = <7>;
	rx-pin = <6>;
};

#else

&uart136 {
	tx-pin = < (2*32 + 4) >;
	rx-pin = < (2*32 + 5) >;
};

&uart135 {
	tx-pin = < (1*32 + 4) >;
	rx-pin = < (1*32 + 5) >;
};

#endif
