## CMakeLists.txt
```
#
# Copyright (c) 2020 Nordic Semiconductor
#
# SPDX-License-Identifier: LicenseRef-BSD-5-Clause-Nordic
#

cmake_minimum_required(VERSION 3.8.2)

find_package(Zephyr REQUIRED HINTS $ENV{ZEPHYR_BASE})
project(softsim)

target_sources(app PRIVATE src/main.c)
```

## prj.conf
```kconfig
# Use glue layer
# Tests with the default shmem config
CONFIG_NRF_MODEM_LIB=y
CONFIG_NRF_MODEM_LIB_SYS_INIT=n

CONFIG_HEAP_MEM_POOL_SIZE=1024
CONFIG_AT_CMD=y

CONFIG_LOG=y
CONFIG_NRF_MODEM_LOG=y
CONFIG_LOG_BUFFER_SIZE=32768
CONFIG_LOG_PROCESS_TRIGGER_THRESHOLD=5

CONFIG_NEWLIB_LIBC=y
```

## src/main.c
```c
#include <zephyr.h>

#include <pm_config.h>

#include <nrf_modem.h>
#include <nrf_modem_platform.h>
#include <nrf_modem_at.h>

static const nrf_modem_init_params_t init_params = {
	.ipc_irq_prio = NRF_MODEM_NETWORK_IRQ_PRIORITY,
	.shmem.ctrl = {
		.base = PM_NRF_MODEM_LIB_CTRL_ADDRESS,
		.size = CONFIG_NRF_MODEM_LIB_SHMEM_CTRL_SIZE,
	},
	.shmem.tx = {
		.base = PM_NRF_MODEM_LIB_TX_ADDRESS,
		.size = CONFIG_NRF_MODEM_LIB_SHMEM_TX_SIZE,
	},
	.shmem.rx = {
		.base = PM_NRF_MODEM_LIB_RX_ADDRESS,
		.size = CONFIG_NRF_MODEM_LIB_SHMEM_RX_SIZE,
	},
#if CONFIG_NRF_MODEM_LIB_TRACE_ENABLED
	.shmem.trace = {
		.base = PM_NRF_MODEM_LIB_TRACE_ADDRESS,
		.size = CONFIG_NRF_MODEM_LIB_SHMEM_TRACE_SIZE,
	},
#endif
};

void main(void)
{
	int32_t err;

	printk("SoftSIM sample started.\n");

	err = nrf_modem_init(&init_params, NORMAL_MODE);

	/* Software SIM selection */
	err = nrf_modem_at_printf("AT%%CSUS=2");
	if (err) {
		printk("Failed to write AT command, err %d\n", err);
		return;
	}

	err = nrf_modem_at_printf("AT+CFUN=41");
	if (err) {
		printk("Failed to write AT command, err %d\n", err);
		return;
	}

	while (1) {
		k_sleep(K_MSEC(1));
	}
}
```
