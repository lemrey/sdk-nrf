## prj.conf
```kconfig
#
# Copyright (c) 2019 Nordic Semiconductor ASA
#
# SPDX-License-Identifier: LicenseRef-Nordic-5-Clause
#

# Modem library
CONFIG_NRF_MODEM_LIB=y

CONFIG_SHELL=y
CONFIG_SHELL_BACKEND_SERIAL=y
CONFIG_AT_SHELL=y

#CONFIG_TEST_DEFAULTS=n

CONFIG_LOG=y
CONFIG_LOG_PRINTK=y
CONFIG_SERIAL=y
CONFIG_CONSOLE=y
CONFIG_UART_CONSOLE=y
CONFIG_LOG_BACKEND_UART=y

CONFIG_LOG_BUFFER_SIZE=8192

CONFIG_LOG_BACKEND_FORMAT_TIMESTAMP=n
CONFIG_LOG_TRACE_SHORT_TIMESTAMP=n
CONFIG_LOG_FUNC_NAME_PREFIX_DBG=n

# CONFIG_HEAP_MEM_POOL_SIZE=1024
# CONFIG_MAIN_STACK_SIZE=4096
# CONFIG_NETWORKING=y
# CONFIG_NET_SOCKETS=y
# CONFIG_NET_SOCKETS_POSIX_NAMES=y
# CONFIG_NET_NATIVE=n

CONFIG_NRF_MODEM_BUILD_FROM_SRC=y
CONFIG_NRF_MODEM_LOG=y
CONFIG_NRF_MODEM_LIB_LOG_LEVEL_DBG=y
```

## boards/nrf9230dk_nrf9230_cpuapp.overlay
```dts
/ {
	chosen {

		zephyr,shell-uart = &uart136;

	};
};
```

## src/main.c
```c
/*
 * Copyright (c) 2018 Nordic Semiconductor ASA
 *
 * SPDX-License-Identifier: LicenseRef-Nordic-5-Clause
 */

#include <stdio.h>
#include <string.h>
#include <zephyr/kernel.h>
#include <modem/nrf_modem_lib.h>

int main(void)
{
	int err;
#if 0
	static volatile int stop = 1;
	while (stop) {;}
#endif

	printk("The AT client sample started\n");
	k_sleep(K_SECONDS(10));
	printk("CAN IT WORK\n");

	err = nrf_modem_lib_init();
	if (err) {
		printk("Modem library initialization failed, error: %d\n", err);
		return 0;
	}
	printk("Ready\n");

	return 0;
}
```
