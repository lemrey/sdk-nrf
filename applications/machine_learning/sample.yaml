## applications/machine_learning/sample.yaml
```yaml
sample:
  name: Machine learning
  description: Machine learning application reference design
tests:
  applications.machine_learning.zdebug:
    build_only: true
    platform_allow: nrf52840dk_nrf52840 thingy53_nrf5340_cpuapp thingy53_nrf5340_cpuapp_ns nrf5340dk_nrf5340_cpuapp
    integration_platforms:
      - nrf52840dk_nrf52840
      - thingy53_nrf5340_cpuapp
      - thingy53_nrf5340_cpuapp_ns
      - nrf5340dk_nrf5340_cpuapp
    tags: ci_build
  applications.machine_learning.zdebug.singlecore:
    build_only: true
    platform_allow: nrf54h20dk_nrf54h20_cpuapp@soc1
    integration_platforms:
      - nrf54h20dk_nrf54h20_cpuapp@soc1
    tags: ci_build
    extra_args: CONF_FILE=prj_singlecore.conf SHIELD="sensor_hub"
  applications.machine_learning.zdebug:
    build_only: true
    platform_allow: nrf54h20dk_nrf54h20_cpuapp@soc1
    integration_platforms:
      - nrf54h20dk_nrf54h20_cpuapp@soc1
    tags: ci_build
    extra_args: SHIELD="sensor_hub" remote_SHIELD="sensor_hub"
  applications.machine_learning.zdebug.fpga.singlecore:
    build_only: true
    platform_allow: nrf54h20dk_nrf54h20_cpuapp@soc1
    integration_platforms:
      - nrf54h20dk_nrf54h20_cpuapp@soc1
    tags: ci_build
    extra_args: CONF_FILE=prj_singlecore.conf SHIELD="sensor_hub"
    extra_configs:
      - CONFIG_EMULATOR_FPGA=y
  applications.machine_learning.zdebug.fpga:
    build_only: true
    platform_allow: nrf54h20dk_nrf54h20_cpuapp@soc1
    integration_platforms:
      - nrf54h20dk_nrf54h20_cpuapp@soc1
    tags: ci_build
    extra_args: remote_CONFIG_EMULATOR_FPGA=y SHIELD="sensor_hub" remote_SHIELD="sensor_hub"
    extra_configs:
      - CONFIG_EMULATOR_FPGA=y
  applications.machine_learning.zdebug_nus:
    build_only: true
    platform_allow: nrf52840dk_nrf52840
    integration_platforms:
      - nrf52840dk_nrf52840
    tags: ci_build
    extra_args: CONF_FILE=prj_nus.conf
  applications.machine_learning.zdebug_rtt:
    build_only: true
    platform_allow: thingy53_nrf5340_cpuapp thingy53_nrf5340_cpuapp_ns
    integration_platforms:
      - thingy53_nrf5340_cpuapp
      - thingy53_nrf5340_cpuapp_ns
    tags: ci_build
    extra_args: CONF_FILE=prj_rtt.conf
  applications.machine_learning.zrelease:
    build_only: true
    platform_allow: nrf52840dk_nrf52840 thingy53_nrf5340_cpuapp thingy53_nrf5340_cpuapp_ns
    integration_platforms:
      - nrf52840dk_nrf52840
      - thingy53_nrf5340_cpuapp
      - thingy53_nrf5340_cpuapp_ns
    tags: ci_build
    extra_args: CONF_FILE=prj_release.conf
```

## applications/machine_learning/src/Kconfig.ml_app
```kconfig
#
# Copyright (c) 2022 Nordic Semiconductor ASA
#
# SPDX-License-Identifier: LicenseRef-Nordic-5-Clause
#

menu "Application options"

config ML_APP_INCLUDE_REMOTE_IMAGE
	bool "Include remote image build"
	depends on SOC_NRF54H20_CPUAPP

config ML_APP_REMOTE_BOARD
	string "The name of the board to be used by remote image"
	depends on ML_APP_INCLUDE_REMOTE_IMAGE
	default "nrf54h20dk_nrf54h20_cpuppr@soc1" if (BOARD_NRF54H20DK_NRF54H20_CPUAPP && HW_REVISION_SOC1)

config ML_APP_SENSOR_EVENT_DESCR
	string "Description of handled sensor event"
	default ""
	help
	  The application handles sensor events with predefined description.
	  Other sensor events are ignored.

endmenu
```

## applications/nrf_desktop/src/modules/Kconfig.dfu_mcumgr_suit
```kconfig
#
# Copyright (c) 2023 Nordic Semiconductor ASA
#
# SPDX-License-Identifier: LicenseRef-Nordic-5-Clause
#

menuconfig DESKTOP_DFU_MCUMGR_SUIT_ENABLE
	bool "Enable SUIT DFU using MCUmgr [EXPERIMENTAL]"
	select EXPERIMENTAL
	select CAF_BLE_SMP_TRANSFER_EVENTS if MCUMGR_TRANSPORT_BT
	select MCUMGR
	select MCUMGR_MGMT_NOTIFICATION_HOOKS
	select MCUMGR_SMP_COMMAND_STATUS_HOOKS
	select MCUMGR_SMP_LEGACY_RC_BEHAVIOUR
	select MGMT_SUITFU
	select NET_BUF
	select ZCBOR
	select CRC
	select FLASH_MAP
	select FLASH
	depends on SUIT
	help
	  This option enables an alternative method of performing SUIT DFU using the
	  MCUmgr module.

if DESKTOP_DFU_MCUMGR_SUIT_ENABLE

module = DESKTOP_DFU_MCUMGR_SUIT
module-str = SUIT DFU MCUmgr
source "subsys/logging/Kconfig.template.log_config"

endif
```

## applications/nrf_desktop/src/modules/Kconfig.usb_state
```kconfig
#
# Copyright (c) 2018 Nordic Semiconductor
#
# SPDX-License-Identifier: LicenseRef-Nordic-5-Clause
#

menuconfig DESKTOP_USB_ENABLE
	bool "Enable USB module"
	select USB_DEVICE_STACK
	select USB_DEVICE_HID
	help
	  Enables USB module. The module allows to transfer HID reports over
	  USB.

if DESKTOP_USB_ENABLE

config DESKTOP_USB_REMOTE_WAKEUP
	bool "Enable USB remote wakeup"
	default y
	select USB_DEVICE_REMOTE_WAKEUP
	depends on CAF_PM_EVENTS
	help
	  Enable USB remote wakeup functionality. The USB wakeup request is
	  triggered on wake_up_event.

config DESKTOP_USB_SELECTIVE_REPORT_SUBSCRIPTION
	bool "Subscribe only for predefined subset of HID reports"
	depends on DESKTOP_HID_STATE_ENABLE
	help
	  By default, every USB HID instance subscribes for all the HID reports.
	  Enable this option to specify a subset of HID reports for every USB
	  HID instance. The subset of HID reports must be specified in
	  usb_state_def.h file in application configuration directory for given
	  board and configuration.

config DESKTOP_USB_PM_ENABLE
	bool "Enable USB power manager integration"
	depends on CAF_PM_EVENTS
	select CAF_FORCE_POWER_DOWN_EVENTS
	default y
	help
	  This enables small module that blocks power down if the USB is active.

config DESKTOP_USB_STATE_INIT_STATE_WORKAROUND
	bool
	default y if SOC_SERIES_NRF54HX
	help
	  For some USB controllers, the USB_DC_SUSPEND event may be received
	  before the USB_DC_CONNECTED event. Setting initial state of the USB
	  state module to USB_STATE_POWERED prevents assertion failure during
	  application boot.
	  The workaround is needed for the nRF54HX SoC use-case.

config DESKTOP_USB_STATE_INIT_THREAD
	bool
	default y if SOC_SERIES_NRF54HX
	help
	  Initialize USB stack in a separate thread instead of doing it in
	  the context of the system workqueue.
	  For the nRF54HX SoC use-case, the usb_init() function blocks while
	  waiting for a synchronization object that is received after the system
	  controller sends the USB service event through the NRFS and IPC with
	  the ICMSG backend to the application core.
	  The ICMSG backend uses the system workqueue context for both
	  initialization and on the incoming message handling, so calling the
	  usb_init() function from the same context causes deadlock during
	  application boot.

config DESKTOP_USB_STATE_INIT_THREAD_STACK_SIZE
	int
	default 2048

config DESKTOP_USB_STATE_INIT_THREAD_PRIORITY
	int
	default 0

config DESKTOP_USB_STATE_INIT_THREAD_DELAY_MS
	int
	default 0

config USB_HID_POLL_INTERVAL_MS
	default 1
	help
	  Use small USB HID Device polling interval to ensure low latency.

config USB_HID_DEVICE_COUNT
	default DESKTOP_HID_DONGLE_BOND_COUNT if DESKTOP_ROLE_HID_DONGLE
	default 1 if DESKTOP_ROLE_HID_PERIPHERAL
	help
	  By default, dongle uses a dedicated USB HID instance to forward data
	  from given peripheral to the host. On memory-limited dongles, a
	  single USB HID instance can be used to forward HID reports from all
	  of the connected peripherals.

	  By default, peripheral uses a single USB HID instance to send all of
	  the HID reports.

config USB_HID_BOOT_PROTOCOL
	default y if DESKTOP_HID_BOOT_INTERFACE_MOUSE
	default y if DESKTOP_HID_BOOT_INTERFACE_KEYBOARD

config USB_HID_PROTOCOL_CODE
	default 2 if DESKTOP_HID_BOOT_INTERFACE_MOUSE
	default 1 if DESKTOP_HID_BOOT_INTERFACE_KEYBOARD

config USB_DEVICE_MANUFACTURER
	default DESKTOP_DEVICE_MANUFACTURER
	help
	  nRF Desktop defines common HID device identification values
	  and passes them as defaults to the USB subsystem configuration.

config USB_DEVICE_PRODUCT
	default DESKTOP_DEVICE_PRODUCT
	help
	  nRF Desktop defines common HID device identification values
	  and passes them as defaults to the USB subsystem configuration.

config USB_DEVICE_VID
	default DESKTOP_DEVICE_VID
	help
	  nRF Desktop defines common HID device identification values
	  and passes them as defaults to the USB subsystem configuration.

config USB_DEVICE_PID
	default DESKTOP_DEVICE_PID
	help
	  nRF Desktop defines common HID device identification values
	  and passes them as defaults to the USB subsystem configuration.

choice USB_DEVICE_LOG_LEVEL_CHOICE
	default USB_DEVICE_LOG_LEVEL_OFF
	help
	  Disable USB device logs to avoid flooding logs.
endchoice

choice USB_DRIVER_LOG_LEVEL_CHOICE
	default USB_DRIVER_LOG_LEVEL_OFF
	help
	  Disable USB driver logs to avoid flooding logs.
endchoice

module = DESKTOP_USB_STATE
module-str = USB state
source "subsys/logging/Kconfig.template.log_config"

endif # DESKTOP_USB_ENABLE
```

## applications/nrf_desktop/src/util/Kconfig
```kconfig
#
# Copyright (c) 2022 Nordic Semiconductor
#
# SPDX-License-Identifier: LicenseRef-Nordic-5-Clause
#

menu "Utilities"

config DESKTOP_HWID
	bool "Hardware ID module"
	select HWINFO
	help
	  Enable nRF Desktop hardware ID utility. The hardware ID is obtained
	  from Zephyr hwinfo driver.

config DESKTOP_HWINFO_BLE_ADDRESS_FICR
	bool
	default y
	depends on BOARD_NRF54H20DK_NRF54H20_CPUAPP

config DESKTOP_HWINFO_BLE_ADDRESS_FICR_POSTFIX
	hex "Postfix for HW ID derived from BLE address"
	range 0x0000 0xffff
	default 0x0b1e
	depends on DESKTOP_HWINFO_BLE_ADDRESS_FICR
	help
	  Postfix appended in big-endian to the HW ID derived from the BLE address.

config HWINFO_NRF
	bool
	default n if BOARD_NRF54H20DK_NRF54H20_CPUAPP
	help
	  The nRF HWINFO driver does not support nRF54H20 yet.

config DESKTOP_ADV_PROV_UUID16_ALL
	bool "UUID16 advertising provider"
	depends on BT_ADV_PROV
	depends on (DESKTOP_HIDS_ENABLE || DESKTOP_BAS_ENABLE)
	help
	  Adds all UUID16 to the advertising payload if used Bluetooth local
	  identity has no bond.

endmenu
```

## applications/peripheral_sensor_node/sample.yaml
```yaml
sample:
  name: Peripheral Sensor Node
  description: Peripheral Sensor Node application reference design
tests:
  applications.peripheral_sensor_node:
    build_only: true
    platform_allow: nrf54l15dk_nrf54l15_cpuapp@soc1
    integration_platforms:
      - nrf54l15dk_nrf54l15_cpuapp@soc1
    tags: ci_build
    extra_args: SHIELD="peripheral_sensor_node"
```

## applications/peripheral_sensor_node/src/events/Kconfig.app_sensor_event
```kconfig
#
# Copyright (c) 2023 Nordic Semiconductor
#
# SPDX-License-Identifier: LicenseRef-Nordic-5-Clause
#

menuconfig APP_SENSOR_EVENTS
	bool "Enable application sensor events"
	help
	  Enable support for application sensor events.

if APP_SENSOR_EVENTS

module = APP_SENSOR_EVENTS
module-str = app sensor events
source "subsys/logging/Kconfig.template.log_config"

endif # APP_SENSOR_EVENTS
```

## applications/peripheral_sensor_node/src/modules/Kconfig
```kconfig
#
# Copyright (c) 2023 Nordic Semiconductor
#
# SPDX-License-Identifier: LicenseRef-Nordic-5-Clause
#

menu "Application modules"

rsource "Kconfig.sensors"

endmenu
```

## applications/thread_border_router/src/net/Kconfig
```kconfig
#
# Copyright (c) 2023 Nordic Semiconductor
#
# SPDX-License-Identifier: LicenseRef-Nordic-5-Clause
#

config NRF_TBR_ROUTE_IPV4
    bool "Route IPv4 packets"
    depends on OPENTHREAD_NAT64_BORDER_ROUTING
    imply NET_PKT_FILTER
    imply NET_PKT_FILTER_IPV4_HOOK
    help
      Enable IPv4 packets routing between interfaces.

if NRF_TBR_ROUTE_IPV4
config NRF_TBR_ROUTE_IPV4_INIT_PRIORITY
    int
    default 90
    help
      Initialization priority.

module = NRF_TBR_ROUTEV4
module-dep = LOG
module-str = IPv4 packets routing
source "subsys/logging/Kconfig.template.log_config"
endif # NRF_TBR_ROUTE_IPV4

config NRF_TBR_NAT
    bool "Enable NAT"
    depends on NRF_TBR_ROUTE_IPV4
    help
      Enable Network Address Translator (NAT).

if NRF_TBR_NAT
config NRF_TBR_NAT_INIT_PRIORITY
    int
    default 89
    help
      Initialization priority must be higher (lower value) than
      for NRF_TBR_ROUTE_IPV4_INIT_PRIORITY.

config NRF_TBR_NAT_RECORDS_COUNT
    int "Number of NAT records in the pool"
    default 25
    help
      Number of total NAT records available for TCP, UDP and ICMP protocols.

config NAT_ICMP_QUERY_SESSION_TIMEOUT_SEC
    int "NAT mapping timout for ICMP query"
    range 60 240
    default 60
    help
      The mapping timeout is the amount of time where NAT mapping will
      stay active without packets traversing the NAT.

config NAT_UDP_SESSION_TIMEOUT_SEC
    int "NAT mapping timout for UDP"
    range 120 65535
    default 300
    depends on NET_UDP
    help
      The mapping timeout is the amount of time where NAT mapping will
      stay active without packets traversing the NAT.

config NAT_TCP_SESSION_TIMEOUT_SEC
    int "NAT mapping timout for TCP"
    range 7440 65535
    default 7440
    depends on NET_TCP
    help
      The mapping timeout is the amount of time where NAT mapping will
      stay active without packets traversing the NAT.

module = NRF_TBR_NAT
module-dep = LOG
module-str = NAT
source "subsys/logging/Kconfig.template.log_config"
endif # NRF_TBR_NAT

config NRF_TBR_MDNS_SERVER_NUM_LISTENERS
    int "Maximum number of mDNS listeners"
    default 1
    help
      Defines a number of listeners that can be started for mDNS
      server. There can be only one listener per network interface.

config NRF_TBR_MDNS_SERVER_NUM_RECORDS
    int "Maximum number of mDNS records"
    default 24
    help
      Defines a number of mDNS records that can be allocated.

config NRF_TBR_MDNS_SERVER_DATA_BUFFER_COUNT
    int "Number of buffers available for mDNS records"
    default 64
    help
      Defines a number of data buffers to be used for storage of mDNS
      records' names and data - hostnames, addresses etc.

config NRF_TBR_MDNS_SERVER_DATA_BUFFER_SIZE
    int "Size of a single data buffer for mDNS records"
    default 16
    help
      Defines a size of a single data buffer used during allocation of
      mDNS records. The buffer size should be chosen to match needs
      of the application.

module = NRF_TBR_MDNS_SERVER
module-dep = LOG
module-str = mDNS server
source "subsys/logging/Kconfig.template.log_config"
```

## applications/thread_border_router/tests/utils/testcase.yaml
```yaml
tests:
  nrf_tbr.utils:
    platform_allow: native_posix
    integration_platforms:
      - native_posix
    tags: nrf_tbr_utils
```

## drivers/sensor/sensor_stub/Kconfig
```kconfig
# Sensor data simulator
#
# Copyright (c) 2022 Nordic Semiconductor
#
# SPDX-License-Identifier: LicenseRef-Nordic-5-Clause
#

DT_COMPAT_NORDIC_SENSOR_STUB := nordic,sensor-stub

menuconfig SENSOR_STUB
	bool "Simplest sensor simulator"
	default y if $(dt_compat_enabled,$(DT_COMPAT_NORDIC_SENSOR_STUB))
	help
	  Enable simplest sensor simulator that just calls callback to generate the value.
```

## dts/bindings/serial/nordic,nrf-sw-lpuart.yaml
```yaml
# Copyright (c) 2020 Nordic Semiconductor ASA
# SPDX-License-Identifier: LicenseRef-Nordic-5-Clause

description: |
    Low power UART

compatible: "nordic,nrf-sw-lpuart"

include: uart-device.yaml

properties:
  req-pin-gpios:
    type: phandle-array
    description: Request pin
    required: true

  rdy-pin-gpios:
    type: phandle-array
    description: Ready pin
    required: true
```

## lib/at_cmd_hook/Kconfig
```kconfig
#
# Copyright (c) 2023 Nordic Semiconductor ASA
#
# SPDX-License-Identifier: LicenseRef-Nordic-5-Clause
#

menuconfig AT_CMD_HOOK
	bool "Custom AT commands"

if AT_CMD_HOOK

config AT_HOOK_POST_CB_LEN_MAX
	int "AT hook post callback max length"
	default 32
	help
	   This allows the application to set the size of the AT command string passed to the
	   post callback, when it is allocated on the heap.

module=AT_CMD_HOOK
module-dep=LOG
module-str= AT cmd hook
source "${ZEPHYR_BASE}/subsys/logging/Kconfig.template.log_config"

endif # AT_CMD_HOOK
```
