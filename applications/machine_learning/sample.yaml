## lib/at_custom_cmd/Kconfig
```kconfig
#
# Copyright (c) 2021 Nordic Semiconductor ASA
#
# SPDX-License-Identifier: LicenseRef-Nordic-5-Clause
#

menuconfig AT_CUSTOM_CMD
	bool "Enable custom AT commands"

if AT_CUSTOM_CMD

config AT_CUSTOM_CMD_SYS_INIT
	bool "Initialize during SYS_INIT"
	default y

module=AT_CUSTOM_CMD
module-dep=LOG
module-str= AT custom command library
source "${ZEPHYR_BASE}/subsys/logging/Kconfig.template.log_config"

endif # AT_CUSTOM_CMD
```

## lib/at_sms_cert/Kconfig
```kconfig
# Copyright (c) 2021 Nordic Semiconductor
#
# SPDX-License-Identifier: LicenseRef-Nordic-5-Clause
#

menuconfig AT_SMS_CERT
	bool "Enable AT SMS certification"
	depends on SOC_NRF9160_SICA
	help
	  Enable AT SMS certification filter.

if AT_SMS_CERT

config AT_SMS_CERT_SYS_INIT
	bool "Initialize during SYS_INIT"
	default y
	help
	  Initialize the AT SMS Certification library automatically during the SYS_INIT sequence.

module = AT_SMS_CERT
module-str = AT SMS Cert
source "subsys/logging/Kconfig.template.log_config"

endif # AT_SMS_CERT
```

## lib/dk_buttons_and_leds/Kconfig
```kconfig
#
# Copyright (c) 2018 Nordic Semiconductor
#
# SPDX-License-Identifier: LicenseRef-Nordic-5-Clause
#

menuconfig DK_LIBRARY
	bool "Button and LED Library for Nordic DKs"
	select GPIO

if DK_LIBRARY

config DK_LIBRARY_BUTTON_SCAN_INTERVAL
	int "Scanning interval of buttons in milliseconds"
	default 50 if DK_LIBRARY_BUTTON_NO_ISR
	default 10

config DK_LIBRARY_DYNAMIC_BUTTON_HANDLERS
	bool "Enable the runtime assignable button handler API"
	default y

config DK_LIBRARY_BUTTON_NO_ISR
	bool "Poll buttons unconditionally (no interrupts)"
	help
	  With this option disabled, the module periodically scans all the
	  available buttons until no button is pressed. If no button is
	  pressed, the module uses GPIO interrupts to detect the first button
	  press. On the first button press, the module switches back to
	  periodically scanning buttons.

	  Enable this option to avoid relying on GPIO interrupts at all and
	  to unconditionally scan all buttons periodically. Please note that
	  the constant scanning activity increases the overall power
	  consumption of the system.

	  For example, the option must be set for the nRF54L15 PDK revision
	  AA0 ES2 in case the application uses Button 3 or 4. This version
	  of the PDK has Button 3 and 4 connected to the GPIO port 2 which
	  does not support interrupts.

module = DK_LIBRARY
module-str = DK library
source "${ZEPHYR_BASE}/subsys/logging/Kconfig.template.log_config"

endif # DK_LIBRARY
```

## lib/gcf_sms_lib/Kconfig
```kconfig
# Copyright (c) 2022 Nordic Semiconductor
#
# SPDX-License-Identifier: LicenseRef-Nordic-5-Clause
#

menuconfig GCF_SMS_LIB
	bool "Custom SMS commands for GCF certification"
	depends on SOC_NRF9160_SICA
	imply AT_CUSTOM_CMD
	help
	  Add implementations for the following AT commands:
	  AT+CPMS
	  AT+CSMS
	  AT+CSCA
	  AT+CSCS
	  AT+CMGD
	  AT+CMSS
	  AT+CMGW
	  AT+CMGF=0
	  AT+CMMS

if GCF_SMS_LIB

config GCF_SMS_LIB_SYS_INIT
	bool "Initialize during SYS_INIT"
	imply AT_CUSTOM_CMD_SYS_INIT
	default y
	help
	  Initialize the GCF SMS library automatically during the SYS_INIT sequence.

module = GCF_SMS_LIB
module-str = GCF SMS Lib
source "subsys/logging/Kconfig.template.log_config"

endif # GCF_SMS_LIB
```

## lib/nrf_modem_lib/trace_backends/flash/Kconfig
```kconfig
#
# Copyright (c) 2022-2023 Nordic Semiconductor
#
# SPDX-License-Identifier: LicenseRef-Nordic-5-Clause
#

# Adds Flash to the trace backend choice.
choice NRF_MODEM_LIB_TRACE_BACKEND

config NRF_MODEM_LIB_TRACE_BACKEND_FLASH
	bool "Stream modem traces to flash"
	select FCB
	select FLASH
	select FLASH_MAP
	help
	  Use flash trace backend. Note that the backend takes time to erase the flash at
	  initialization. It is therefore recommended to disable CONFIG_NRF_MODEM_LIB_SYS_INIT when
	  enabling the Flash trace backend.

endchoice # NRF_MODEM_LIB_TRACE_BACKEND

if NRF_MODEM_LIB_TRACE_BACKEND_FLASH

config NRF_MODEM_LIB_TRACE_BACKEND_FLASH_BUF_SIZE
	int "Flash buffer size"
	default 1024

choice NRF_MODEM_TRACE_FLASH_NOSPACE_POLICY
	prompt "Trace flash no space policy"

config NRF_MODEM_TRACE_FLASH_NOSPACE_SIGNAL
	bool "Do not overwrite trace data that is not read or cleared"
	help
	  The application can be notified when the flash is full by implementing the
	  nrf_modem_lib_trace_callback function.

config NRF_MODEM_TRACE_FLASH_NOSPACE_ERASE_OLDEST
	bool "Allow replacing the oldest trace data with new data"

endchoice # NRF_MODEM_TRACE_FLASH_NOSPACE_POLICY

config NRF_MODEM_TRACE_FLASH_SECTORS
	int "Number of Flash sectors"
	default 16

config PM_PARTITION_SIZE_MODEM_TRACE
	hex "External flash space reserved for modem traces"
	default 0x800000
	help
	  Flash space set aside for modem traces in the external flash.

endif # NRF_MODEM_LIB_TRACE_BACKEND_FLASH
```

## nrf5_sdk/libraries/Kconfig
```kconfig
config BSP_BTN_BLE_OBSERVER_PRIO
    int "BSP button BLE Observer priority"
    default 1

config APP_BUTTON
    select NRF5_SDK_IRQ_CONNECT_GPIOTE
    select NRFX_GPIOTE
    bool "App button"

config APP_BUTTON_HIGH_ACCURACY_ENABLED
    bool "App button high accuracy"
    depends on APP_BUTTON

rsource "Kconfig.irq_connect"
rsource "fstorage/Kconfig"
rsource "fds/Kconfig"
```

## nrf5_sdk/libraries/fds/Kconfig
```kconfig
# Copyright (c) 2019 Nordic Semiconductor
#
# SPDX-License-Identifier: LicenseRef-Nordic-5-Clause
#

config FDS
	bool "Flash Data Storage"
	help
	  Enable Flash Data Storage

if FDS

if FDS

config FDS_VIRTUAL_PAGES
	int "Number of pages"
	default 2

config FDS_VIRTUAL_PAGE_SIZE
	int "Virtual page size, in bytes"
	default 4096

config FDS_VIRTUAL_PAGES_RESERVED
	int "Reserved pages"
	default 0

config FDS_OP_QUEUE_SIZE
	int "Queue size"
	default 3

config FDS_MAX_USERS
	int "Max number of handlers"
	default 3

choice
	prompt "FDS Backend"
	default FDS_BACKEND_SD if NRF_FSTORAGE_SD
	default FDS_BACKEND_NVMC if NRF_FSTORAGE_NVMC

config FDS_BACKEND_SD
	bool "Softdevice"
config FDS_BACKEND_NVMC
	bool "NVMC"
endchoice

config FDS_BACKEND
	int
	default 1 if NRF_FSTORAGE_NVMC
	default 2 if NRF_FSTORAGE_SD

endif # FDS

endif
```

## nrf5_sdk/libraries/fstorage/Kconfig
```kconfig
# Copyright (c) 2019 Nordic Semiconductor
#
# SPDX-License-Identifier: LicenseRef-Nordic-5-Clause
#

config NRF_FSTORAGE
	bool "fstorage"
	help
	  Enable fstorage

if NRF_FSTORAGE

choice
	prompt "backend"
config NRF_FSTORAGE_SD
	bool "SoftDevice"
config NRF_FSTORAGE_NVMC
	bool "NVMC"
endchoice

if NRF_FSTORAGE_SD

config NRF_FSTORAGE_SD_MAX_WRITE_SIZE
	int "Maximum write size"
	default 20

config NRF_FSTORAGE_SD_QUEUE_SIZE
	int "Queue size"
	default 8

config NRF_FSTORAGE_SD_MAX_RETRIES
	int "Maximum number of retries for an operation"
	default 3

endif # NRF_FSTORAGE_SD

endif
```

## nrf5_sdk/softdevice/Kconfig
```kconfig
menu "Softdevice"

config S140
	bool "S140"
	select SOFTDEVICE
	select SOFTDEVICE_BLE

config SOFTDEVICE
	bool

config SOFTDEVICE_BLE
	bool

choice NRF_SDH_DISPATCH_MODEL
	prompt "Dispatch model"
	default NRF_SDH_DISPATCH_MODEL_INTERRUPT

config NRF_SDH_DISPATCH_MODEL_INTERRUPT
	bool "Interrupt"

config NRF_SDH_DISPATCH_MODEL_APPSH
	bool "App scheduler"

config NRF_SDH_DISPATCH_MODEL_POLLING
	bool "Polling"

endchoice

config NRF_SDH_CLOCK_LF_SRC
	int "LF Clock"
	default 1

config NRF_SDH_CLOCK_LF_RC_CTIV
	int "Calibration timer interval"
	default 0

config NRF_SDH_CLOCK_LF_RC_TEMP_CTIV
	int "Calibration timer interval"
	default 0

config NRF_SDH_CLOCK_LF_ACCURACY
	int "Accuracy"
	default 0

config NRF_SDH_REQ_OBSERVER_PRIO_LEVELS
	int "Total number of priority levels for request observers"
	default 2

config NRF_SDH_STATE_OBSERVER_PRIO_LEVELS
	int "Total number of priority levels for state observers."
	default 2

config NRF_SDH_STACK_OBSERVER_PRIO_LEVELS
	int "Total number of priority levels for stack event observers"
	default 2

config NRF_SDH_SOC_OBSERVER_PRIO_LEVELS
	int "Number of Observer priority levels"
	default 2

config NRF_SDH_SOC_STACK_OBSERVER_PRIO
	int "Stack Event Observers priorities"
	default 0

config NRF_SDH_BLE_PERIPHERAL_LINK_COUNT
	int "Maximum number of peripheral links"
	default 0

config NRF_SDH_BLE_CENTRAL_LINK_COUNT
	int "Maximum number of central links"
	default 0

config NRF_SDH_BLE_TOTAL_LINK_COUNT
	int "Maximum number of total concurrent connections using the default configuration"
	default 1

config NRF_SDH_BLE_GAP_DATA_LENGTH
	int "GAP data length"
	default 27

config NRF_SDH_BLE_GAP_EVENT_LENGTH
	int "GAP event length"
	default 6

config NRF_SDH_BLE_GATT_MAX_MTU_SIZE
	int "Static maximum MTU size"
	default 23

config NRF_SDH_BLE_GATTS_ATTR_TAB_SIZE
	int "Attribute Table size in bytes"
	default 1408
	help
	  The size must be a multiple of 4.
config NRF_SDH_BLE_VS_UUID_COUNT
	int "The number of vendor-specific UUIDs"
	default 0

config NRF_SDH_BLE_SERVICE_CHANGED
	bool "Include the Service Changed characteristic in the Attribute Table"

config NRF_SDH_BLE_STACK_OBSERVER_PRIO
	int "Stack Event Observers priorities"
	default 0

config NRF_SDH_BLE_OBSERVER_PRIO_LEVELS
	int "Total number of priority levels for BLE observers"
	default 4

endmenu
```

## samples/bluetooth/central_and_peripheral_hr/sample.yaml
```yaml
sample:
  description: Bluetooth Low Energy central and peripheral heart rate relay sample
  name: BLE Central and Peripheral HRS
tests:
  sample.bluetooth.central_and_peripheral_hr.build:
    build_only: true
    integration_platforms:
      - nrf52dk_nrf52832
      - nrf52840dk_nrf52840
      - nrf5340dk_nrf5340_cpuapp
      - nrf5340dk_nrf5340_cpuapp_ns
      - nrf54h20dk_nrf54h20_cpuapp@soc1
    platform_allow: nrf52dk_nrf52832 nrf52840dk_nrf52840 nrf5340dk_nrf5340_cpuapp
      nrf5340dk_nrf5340_cpuapp_ns nrf54h20dk_nrf54h20_cpuapp@soc1
    tags: bluetooth ci_build
```

## samples/bluetooth/central_uart/Kconfig
```kconfig
#
# Copyright (c) 2023 Nordic Semiconductor
#
# SPDX-License-Identifier: LicenseRef-Nordic-5-Clause
#

source "Kconfig.zephyr"

menu "Nordic Central UART BLE sample"

config BT_UART_ASYNC_ADAPTER
	bool "Enable UART async adapter"
	select SERIAL_SUPPORT_ASYNC
	help
	  Enables asynchronous adapter for UART driver that supports only
	  IRQ interface.

endmenu
```

## samples/bluetooth/central_uart/boards/nrf54l15dk_nrf54l15_cpuapp_soc1.conf
```kconfig
#
# Copyright (c) 2023 Nordic Semiconductor
#
# SPDX-License-Identifier: LicenseRef-Nordic-5-Clause
#

# Disable the unsupported driver
CONFIG_NRFX_UARTE0=n
```
