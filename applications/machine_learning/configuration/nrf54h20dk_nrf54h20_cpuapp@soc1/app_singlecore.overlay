/*
 * Copyright (c) 2023 Nordic Semiconductor ASA
 *
 * SPDX-License-Identifier: LicenseRef-Nordic-5-Clause
 */

#include "app.overlay"

&spi130 {
	memory-regions = <&ram3x_cpuapp>;
	/* Override the default (multicore) configuration status. */
	status = "okay";
};
