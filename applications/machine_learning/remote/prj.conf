## CMakeLists.txt
```
#
# Copyright (c) 2023 Nordic Semiconductor ASA
#
# SPDX-License-Identifier: LicenseRef-Nordic-5-Clause
#

cmake_minimum_required(VERSION 3.20.0)

if (NOT EXISTS "${CMAKE_CURRENT_SOURCE_DIR}/configuration/${BOARD}")
  message(FATAL_ERROR
          "Board ${BOARD} is not supported.\n"
          "Please make sure board specific configuration files are added to "
          "${CMAKE_CURRENT_SOURCE_DIR}/configuration/${BOARD}")
endif()

################################################################################

# The application uses the configuration/<board> scheme for configuration files.
set(APPLICATION_CONFIG_DIR "configuration/\${BOARD}")
string(CONFIGURE ${APPLICATION_CONFIG_DIR} APPLICATION_CONFIG_DIR)

find_package(Zephyr REQUIRED HINTS $ENV{ZEPHYR_BASE})

project(remote)

target_sources(app PRIVATE src/main.c)

# Add include directory for board specific CAF def files
zephyr_include_directories(
  ../configuration/common
  /configuration
  ${APPLICATION_CONFIG_DIR})

# Add subdirectory from common part.
add_subdirectory(../common/src/modules ${CMAKE_CURRENT_BINARY_DIR}/common/src/module)
```

## Kconfig
```
#
# Copyright (c) 2023 Nordic Semiconductor ASA
#
# SPDX-License-Identifier: LicenseRef-Nordic-5-Clause
#

menu "Machine learning application (remote core)"

rsource "../common/Kconfig"
# Kconfig.ml_app should land in "../common/src/" but im not
# placing it there just to avoid conflicts when HCS will is synced with NCS
rsource "../src/Kconfig.ml_app"

endmenu

menu "Zephyr Kernel"
source "Kconfig.zephyr"
endmenu
```

## prj.conf
```kconfig
#
# Copyright (c) 2023 Nordic Semiconductor ASA
#
# SPDX-License-Identifier: LicenseRef-Nordic-5-Clause
#
################################################################################
# Application configuration

CONFIG_CAF=y

CONFIG_CAF_INIT_LOG_SENSOR_EVENTS=n

CONFIG_CAF_SENSOR_MANAGER=y

CONFIG_APP_EVENT_MANAGER=y
CONFIG_EVENT_MANAGER_PROXY=y
CONFIG_HEAP_MEM_POOL_SIZE=4096
CONFIG_REBOOT=y

CONFIG_SENSOR=y

CONFIG_IPC_SERVICE=y
CONFIG_MBOX=y

CONFIG_OPENAMP=y
CONFIG_OPENAMP_MASTER=n

################################################################################
# Debug configuration

CONFIG_ASSERT=y
CONFIG_RESET_ON_FATAL_ERROR=n

# Disable GPIO
CONFIG_GPIO=n

CONFIG_LOG=y
CONFIG_LOG_MODE_DEFERRED=y
```

## src/main.c
```c
/*
 * Copyright (c) 2023 Nordic Semiconductor ASA
 *
 * SPDX-License-Identifier: LicenseRef-Nordic-5-Clause
 */

#include <zephyr/kernel.h>
#include <app_event_manager.h>

#define MODULE main
#include <caf/events/module_state_event.h>

#include <zephyr/logging/log.h>
LOG_MODULE_REGISTER(MODULE);

void main(void)
{
	if (app_event_manager_init()) {
		LOG_ERR("Application Event Manager initialization failed");
		__ASSERT_NO_MSG(false);
	} else {
		module_set_state(MODULE_STATE_READY);
	}
}
```
